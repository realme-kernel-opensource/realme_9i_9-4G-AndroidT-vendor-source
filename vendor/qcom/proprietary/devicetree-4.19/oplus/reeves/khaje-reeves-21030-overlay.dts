/dts-v1/;
/plugin/;

#include "../../qcom/khaje-qrd-nopmi-overlay.dts"
#include "khaje_overlay_common.dtsi"
#include "khaje_21030_overlay_common.dtsi"
#include "reeves-charger.dtsi"

/ {
    model = "Qualcomm Technologies, Inc. KHAJE QRD nopmi overlay, reeves";
    oplus,dtsi_no = <21030>;
    oplus,pcb_range = <31 59>;
};
