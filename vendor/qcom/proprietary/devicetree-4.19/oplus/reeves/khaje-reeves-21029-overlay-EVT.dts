/dts-v1/;
/plugin/;

#include "../../qcom/khaje-qrd-nopmi-overlay.dts"
#include "khaje_overlay_common.dtsi"
#include "khaje_21029_overlay_common.dtsi"
#include "reeves-charger-EVT.dtsi"
/ {
    model = "Qualcomm Technologies, Inc. KHAJE QRD nopmi overlay, reeves";
    oplus,dtsi_no = <21029>;
    oplus,pcb_range = <0 30>;
};
