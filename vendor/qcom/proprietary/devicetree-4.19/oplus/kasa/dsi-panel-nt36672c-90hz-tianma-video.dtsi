&mdss_mdp {
	dsi_nt36672c_120hz_tianma_video: qcom,mdss_dsi_216c1_nt36672c_90hz_tm_video {
		qcom,mdss-dsi-panel-name =
				"nt36672c 90hz tianma fhd video mode dsi panel";
		qcom,mdss-dsi-panel-type = "dsi_video_mode";
		qcom,dsi-ctrl-num = <0>;
		qcom,dsi-phy-num = <0>;
		qcom,mdss-dsi-virtual-channel-id = <0>;
		qcom,mdss-dsi-stream = <0>;
		qcom,mdss-dsi-h-left-border = <0>;
		qcom,mdss-dsi-h-right-border = <0>;
		qcom,mdss-dsi-v-top-border = <0>;
		qcom,mdss-dsi-v-bottom-border = <0>;
		qcom,mdss-dsi-bpp = <24>;
		qcom,mdss-dsi-color-order = "rgb_swap_rgb";
		qcom,mdss-dsi-underflow-color = <0xff>;
		qcom,mdss-dsi-border-color = <0>;
		qcom,mdss-dsi-h-sync-pulse = <0>;
		qcom,mdss-dsi-traffic-mode = "non_burst_sync_event";
		qcom,mdss-dsi-lane-map = "lane_map_0123";
		qcom,mdss-dsi-bllp-eof-power-mode;
		qcom,mdss-dsi-bllp-power-mode;
		qcom,mdss-dsi-tx-eot-append;
		qcom,mdss-dsi-lane-0-state;
		qcom,mdss-dsi-lane-1-state;
		qcom,mdss-dsi-lane-2-state;
		qcom,mdss-dsi-lane-3-state;
		qcom,mdss-dsi-dma-trigger = "trigger_sw";
		qcom,mdss-dsi-mdp-trigger = "none";
		qcom,mdss-dsi-lp11-init;
		//qcom,mdss-dsi-bl-pmic-control-type = "bl_ctrl_dcs";
		qcom,mdss-dsi-bl-min-level = <1>;
		qcom,mdss-dsi-bl-normal-max-level = <3276>;
		qcom,mdss-dsi-bl-max-level = <4095>;
		qcom,mdss-brightness-normal-max-level = <3276>;
		qcom,mdss-brightness-max-level = <4095>;
		qcom,mdss-brightness-default-level = <400>;
		qcom,mdss-dsi-reset-sequence = <1 10>, <0 10>, <1 10>;
		qcom,mdss-pan-physical-width-dimension = <68>;
		qcom,mdss-pan-physical-height-dimension = <153>;
		oplus,mdss-dsi-vendor-name = "NT36672C";
		oplus,mdss-dsi-manufacture = "TIANMA-NT";
		qcom,mdss-dsi-display-timings {
			timing@0 {
				qcom,mdss-dsi-video-mode;
				qcom,mdss-dsi-panel-clockrate = <1107000000>;
				qcom,mdss-dsi-panel-width = <1080>;
				qcom,mdss-dsi-panel-height = <2412>;
				qcom,mdss-dsi-h-front-porch = <223>;
				qcom,mdss-dsi-h-back-porch = <222>;
				qcom,mdss-dsi-h-pulse-width = <20>;
				qcom,mdss-dsi-h-sync-skew = <0>;
				qcom,mdss-dsi-v-back-porch = <10>;
				qcom,mdss-dsi-v-front-porch = <54>;
				qcom,mdss-dsi-v-pulse-width = <10>;
				qcom,mdss-dsi-panel-framerate = <90>;
				qcom,mdss-dsi-on-command = [
					39 01 00 00 00 00 02 FF 10
					39 01 00 00 00 00 02 FB 01
					39 01 00 00 00 00 06 3B 03 14 36 04 04
					39 01 00 00 00 00 02 B0 00
					39 01 00 00 00 00 02 C0 03
					//39 01 00 00 00 00 11 C1 89 28 00 0C 00 AA 02 0E 00 43 00 07 08 BB 08 7A
					//39 01 00 00 00 00 03 C2 1B A0

					39 01 00 00 00 00 02 FF 25
                                        39 01 00 00 00 00 02 FB 01
                                        39 01 00 00 00 00 02 18 21

					39 01 00 00 00 00 02 FF E0
					39 01 00 00 00 00 02 FB 01
					39 01 00 00 00 00 02 35 82

					39 01 00 00 00 00 02 FF F0
					39 01 00 00 00 00 02 FB 01
					39 01 00 00 00 00 02 1C 01
					39 01 00 00 00 00 02 33 01
					39 01 00 00 00 00 02 5A 00

					39 01 00 00 00 00 02 FF D0
					39 01 00 00 00 00 02 FB 01
					39 01 00 00 00 00 02 53 22
					39 01 00 00 00 00 02 54 02

					39 01 00 00 00 00 02 FF C0
                                        39 01 00 00 00 00 02 FB 01
                                        39 01 00 00 00 00 02 9C 11
                                        39 01 00 00 00 00 02 9D 11

					//CABC begin
                    39 01 00 00 00 00 02 FF 23
                    39 01 00 00 00 00 02 FB 01
                    39 01 00 00 00 00 02 00 80
                    39 01 00 00 00 00 02 07 00
                    39 01 00 00 00 00 02 08 01
                    39 01 00 00 00 00 02 09 00
                    39 01 00 00 00 00 02 11 01
                    39 01 00 00 00 00 02 12 95
                    39 01 00 00 00 00 02 15 68
                    39 01 00 00 00 00 02 16 0B
                    39 01 00 00 00 00 02 0A 00
                    39 01 00 00 00 00 02 0B 00
                    39 01 00 00 00 00 02 0C 00
                    39 01 00 00 00 00 02 0D 00
                    39 01 00 00 00 00 02 A0 01

                    39 01 00 00 00 00 02 30 FA
                    39 01 00 00 00 00 02 31 F7
                    39 01 00 00 00 00 02 32 F4
                    39 01 00 00 00 00 02 33 F0
                    39 01 00 00 00 00 02 34 ED
                    39 01 00 00 00 00 02 35 EC
                    39 01 00 00 00 00 02 36 EB
                    39 01 00 00 00 00 02 37 EA
                    39 01 00 00 00 00 02 38 E9
                    39 01 00 00 00 00 02 39 E8
                    39 01 00 00 00 00 02 3A E7
                    39 01 00 00 00 00 02 3B E6
                    39 01 00 00 00 00 02 3D E5
                    39 01 00 00 00 00 02 3F E4
                    39 01 00 00 00 00 02 40 E0
                    39 01 00 00 00 00 02 41 DD

                    39 01 00 00 00 00 02 45 f7 //96.8%
                    39 01 00 00 00 00 02 46 f5
                    39 01 00 00 00 00 02 47 f3
                    39 01 00 00 00 00 02 48 f1
                    39 01 00 00 00 00 02 49 ee
                    39 01 00 00 00 00 02 4a ec //92.54%
                    39 01 00 00 00 00 02 4b ea
                    39 01 00 00 00 00 02 4c e8 //90.98%
                    39 01 00 00 00 00 02 4d dd //86.67%
                    39 01 00 00 00 00 02 4e da
                    39 01 00 00 00 00 02 4f d8
                    39 01 00 00 00 00 02 50 d6
                    39 01 00 00 00 00 02 51 d4
                    39 01 00 00 00 00 02 52 d2
                    39 01 00 00 00 00 02 53 cf
                    39 01 00 00 00 00 02 54 cc //80%

                    39 01 00 00 00 00 02 58 f2 //94.90%
                    39 01 00 00 00 00 02 59 f0
                    39 01 00 00 00 00 02 5a ec
                    39 01 00 00 00 00 02 5b e8
                    39 01 00 00 00 00 02 5c e4
                    39 01 00 00 00 00 02 5d dc //86.27%
                    39 01 00 00 00 00 02 5e d7
                    39 01 00 00 00 00 02 5f d5 //83.5%
                    39 01 00 00 00 00 02 60 d3 //82.74%
                    39 01 00 00 00 00 02 61 d2
                    39 01 00 00 00 00 02 62 d0
                    39 01 00 00 00 00 02 63 ce
                    39 01 00 00 00 00 02 64 cd
                    39 01 00 00 00 00 02 65 cb
                    39 01 00 00 00 00 02 66 c6
                    39 01 00 00 00 00 02 67 c3 //76.47%
					//CABC end

					39 01 00 00 00 00 02 FF 20
                                        39 01 00 00 00 00 02 FB 01
                                        39 01 00 00 00 00 02 2F 83

                                        39 01 00 00 00 00 02 FF 2B
                                        39 01 00 00 00 00 02 FB 01
                                        39 01 00 00 00 00 02 B7 1A
                                        39 01 00 00 00 00 02 B8 14
                                        39 01 00 00 00 00 02 C0 05

					39 01 00 00 00 00 02 FF 10

					39 01 00 00 00 00 03 51 00 00
                                        39 01 00 00 00 00 02 53 2C
                                        39 01 00 00 00 00 02 55 00
					39 01 00 00 00 00 02 35 00

					39 01 00 00 64 00 02 11 00
					39 01 00 00 05 00 02 29 00
				];
				qcom,mdss-dsi-pre-off-command = [
					39 01 00 00 00 00 02 53 24
					39 01 00 00 00 00 03 51 00 00
				];
				qcom,mdss-dsi-off-command = [
					39 01 00 00 14 00 02 28 00
					39 01 00 00 78 00 02 10 00
				];
				qcom,mdss-dsi-cabc-mode1-command = [
					39 01 00 00 00 00 02 FF 10
					39 01 00 00 00 00 02 FB 01
					39 01 00 00 00 00 02 55 01
				];
				qcom,mdss-dsi-cabc-mode2-command = [
					39 01 00 00 00 00 02 FF 10
					39 01 00 00 00 00 02 FB 01
					39 01 00 00 00 00 02 55 02
				];
				qcom,mdss-dsi-cabc-mode3-command = [
					39 01 00 00 00 00 02 FF 10
					39 01 00 00 00 00 02 FB 01
					39 01 00 00 00 00 02 55 03
				];
				qcom,mdss-dsi-cabc-off-command = [
					39 01 00 00 00 00 02 FF 10
					39 01 00 00 00 00 02 FB 01
					39 01 00 00 00 00 02 55 00
				];
				qcom,compression-mode = "dsc";
				qcom,mdss-dsc-slice-height = <12>;
				qcom,mdss-dsc-slice-width = <540>;
				qcom,mdss-dsc-slice-per-pkt = <1>;
				qcom,mdss-dsc-bit-per-component = <8>;
				qcom,mdss-dsc-bit-per-pixel = <8>;
				qcom,mdss-dsc-block-prediction-enable;

				qcom,mdss-dsi-on-command-state = "dsi_lp_mode";
				qcom,mdss-dsi-off-command-state = "dsi_lp_mode";
				qcom,mdss-dsi-cabc-mode1-command-state = "dsi_lp_mode";
				qcom,mdss-dsi-cabc-mode2-command-state = "dsi_lp_mode";
				qcom,mdss-dsi-cabc-mode3-command-state = "dsi_lp_mode";
				qcom,mdss-dsi-cabc-off-command-state = "dsi_lp_mode";
				qcom,mdss-dsi-pre-off-command-state = "dsi_lp_mode";
			};
		};
	};
};
&dsi_nt36672c_120hz_tianma_video {
	qcom,panel-supply-entries = <&dsi_panel_pwr_supply_no_labibb>;
	qcom,mdss-dsi-bl-pmic-control-type = "bl_ctrl_dcs";
	qcom,bl-pmic-pwm-period-usecs = <100>;
	qcom,mdss-dsi-bl-min-level = <1>;
	qcom,mdss-dsi-bl-normal-max-level = <3276>;
	qcom,mdss-dsi-bl-max-level = <4095>;
	qcom,mdss-brightness-normal-max-level = <3276>;
	qcom,mdss-brightness-max-level = <4095>;
	qcom,mdss-brightness-default-level = <1024>;
	qcom,platform-te-gpio = <&tlmm 81 0>;
	qcom,platform-reset-gpio = <&tlmm 82 0>;
	qcom,platform-panel-vddi-gpio = <&tlmm 103 0>;
	qcom,platform-panel-P5V-gpio = <&tlmm 43 0>;
	qcom,platform-panel-N5V-gpio = <&tlmm 54 0>;
	oplus,mdss-dsi-vspn-voltage = <5500>;

	qcom,mdss-dsi-t-clk-post = <0x0F>;
	qcom,mdss-dsi-t-clk-pre = <0x1E>;

	qcom,dsi-supported-dfps-list = <90 60 50 48 30>;
	qcom,mdss-dsi-pan-enable-dynamic-fps;
	qcom,mdss-dsi-pan-fps-update =
		"dfps_immediate_porch_mode_vfp";
	qcom,mdss-dsi-min-refresh-rate = <30>;
	qcom,mdss-dsi-max-refresh-rate = <90>;
	oplus,dfps-idle-off;

	oplus,bl_interpolate_nosub;
	oplus,dsi-brightness-remapping = <4    14>,
	    <362   26>,
            <694   108>,
            <897   190>,
            <1056  272>,
            <1191  354>,
            <1309  436>,
            <1415  518>,
            <1513  599>,
            <1604  681>,
            <1689  763>,
            <1769  845>,
            <1845  927>,
            <1918  1009>,
            <1987  1091>,
            <2053  1173>,
            <2117  1255>,
            <2179  1337>,
            <2239  1418>,
            <2297  1500>,
            <2353  1582>,
            <2407  1664>,
            <2460  1746>,
            <2512  1828>,
            <2563  1910>,
            <2612  1992>,
            <2661  2074>,
            <2708  2156>,
            <2754  2237>,
            <2799  2319>,
            <2844  2401>,
            <2888  2483>,
            <2931  2565>,
            <2973  2647>,
            <3014  2729>,
            <3055  2811>,
            <3095  2893>,
            <3135  2975>,
            <3174  3056>,
            <3212  3138>,
            <3250  3220>,
	    <3276  3276>,
	    <4095  4095>;

	qcom,esd-check-enabled;
	qcom,mdss-dsi-panel-status-check-mode = "reg_read";
	qcom,mdss-dsi-panel-status-command = [06 01 00 01 00 00 01 0A];
	qcom,mdss-dsi-panel-status-command-state = "dsi_lp_mode";
	qcom,mdss-dsi-panel-status-value = <0x9C>;
	qcom,mdss-dsi-panel-on-check-value = <0x9C>;
	qcom,mdss-dsi-panel-status-read-length = <1>;
        qcom,dsi-select-clocks = "mux_byte_clk0", "mux_pixel_clk0";

	qcom,mdss-dsi-display-timings {
		timing@0 {
			qcom,mdss-dsi-panel-phy-timings = [00 24 0A 0A 1A 24 0A
					0A 09 02 04 00 1E 0F];
			qcom,display-topology = <1 1 1>;
			qcom,default-topology-index = <0>;
		};
	};
};
