/dts-v1/;
/plugin/;

#include "../../qcom/khaje-qrd-nopmi-overlay.dts"
#include "khaje_overlay_common.dtsi"
#include "khaje_216C1_overlay_common.dtsi"

/ {
    model = "Qualcomm Technologies, Inc. KHAJE QRD nopmi overlay, kasa";
    oplus,dtsi_no = <136897>;
};