/* *****************
the up part file change like:
delete note  and status = "disabled" to "ok"  add here also, other will meet can't boot issue or compile error issue
**************************/
#include "../../qcom/bengal-qrd.dtsi"
#include "nfc/soda-nfc-sn100t.dtsi"
#include "dsi-panel-oplus20221-am643-samsung-fhd-video.dtsi"
#include "dsi-panel-oplus20221-s6e8fc1-samsung-fhd-video.dtsi"
#include "dsi-panel-oplus20221-s6e8fc1fe-samsung-fhd-video.dtsi"
//#ifdef ODM_HQ_EDIT
/* Gaofei, 2020/1/8, Add for panel bring up */
#include "dsi-panel-ili9881h-boe-fhd-video.dtsi"
#include "dsi-panel-nt36525b-inx-fhd-video.dtsi"
#include "dsi-panel-ili9881h-90hz-boe-fhd-video.dtsi"
#include "dsi-panel-nt36525b-90hz-inx-fhd-video.dtsi"
#include "dsi-panel-ili9881h-90hz-hlt-fhd-video.dtsi"
#include "dsi-panel-ili9882n-90hz-txd-fhd-video.dtsi"
#include "dsi-panel-ili9882n-90hz-boe-fhd-video.dtsi"
#include "dsi-panel-ili9882n-90hz-inx-fhd-video.dtsi"
//#endif
//bengal.dtsi

&qrd_batterydata {
    /delete-node/ qcom,ATL466271_3300mAh;
    #include "oplus_battery_5000mah_1k_pmi632_Liwinon.dtsi"
    #include "oplus_battery_5000mah_15k_pmi632_Coslight.dtsi"
    #include "oplus_battery_5000mah_68k_pmi632_Atl.dtsi"
};
//#ifdef OPLUS_FEATURE_FINGERPRINT
&removed_mem {
	compatible = "removed-dma-pool";
	no-map;
	reg = <0x0 0x60000000 0x0 0x6800000>;
};
&qcom_seecom {
	/delete-property/ reg;
	reg = <0x61800000 0x5000000>;
};
&qcom_smcinvoke {
	/delete-property/ reg;
	reg = <0x61800000 0x5000000>;
};
//#endif /*OPLUS_FEATURE_FINGERPRINT*/

&pil_adsp_mem {
	/delete-property/ reg;
	reg = <0x0 0x53800000 0x0 0x2400000>;
};

&pil_ipa_fw_mem {
	/delete-property/ reg;
	reg = <0x0 0x55C00000 0x0 0x10000>;
};

&pil_ipa_gsi_mem {
	/delete-property/ reg;
	reg = <0x0 0x55C10000 0x0 0x5000>;
};

&pil_gpu_mem {
	/delete-property/ reg;
	reg = <0x0 0x55C15000 0x0 0x2000>;
};

&adsp_mem {
	/delete-property/ reusable;
};

// xbl_uefi_mem address get from boot_images Core.dsc.inc file: PcdEmbeddedFdBaseAddress + SERIAL_BUFFER_OFFSET,0x5FC00000+0x3F7000
// kernel boot log: 0x5FC00000~ 0x5FFF7000
&reserved_memory {
	kboot_uboot_logmem: kboot_uboot_logmem@0x5FC00000 {
		reg = <0x0 0x5FC00000 0x0 0x3FF000>;
		compatible = "oppo,xbl_uefi_kbootlog";
		xbluefi-offset = <0x3F7000>;
		no-map;
	};

	ramoops: ramoops@0x0xB7E00000 {
		compatible = "ramoops";
		reg = <0 0xB7E00000 0 0x00400000>;
		record-size =  <0x40000>; //256x1024
		console-size = <0x40000>;
		ftrace-size =  <0x40000>;
		pmsg-size=         <0x200000>;
		devinfo-size=  <0x01000>;
		ecc-size=          <0x0>;
	};
};
//bengal-qrd.dtsi
&tlmm {
	//#ifdef VENDOR_EDIT
	adsp_accel_gpio: adsp_accel_gpio {
		mux {
			pins = "gpio84";
			function = "gpio";
		};

		config {
			pins = "gpio84";
			drive-strength = <2>;
			bias-pull-up;
		};
	};
	
	adsp_prox_gpio: adsp_prox_gpio {
		mux {
			pins = "gpio82";
			function = "gpio";
		};

		config {
			pins = "gpio82";
			drive-strength = <2>;
			bias-pull-up;
		};
	};
	//#endif
};
&soc {
	gpio_keys {
		vol_up {
			/delete-property/ label;
			label = "volume_down";
			/delete-property/ linux,code;
			linux,code = <KEY_VOLUMEDOWN>;
		};
	};

	//#ifdef VENDOR_EDIT
	//#ifdef FEATURE_OPPO_NV_BACKUP
	//add for creating a shared memory with uio for nv backup and restore
	qcom,oembackup_sharedmem@0 {
		compatible = "qcom,sharedmem-uio";
		reg = <0x0 0x00100000>;
		reg-names = "oembackup";
		qcom,client-id = <0x00000004>;
		qcom,guard-memory;
		qcom,vm-nav-path;
	};
	//#endif /* FEATURE_OPPO_NV_BACKUP */
	//#endif /* VENDOR_EDIT */

	devinfo {
		compatible = "oppo-devinfo";

		io-channels= <&pmi632_vadc ADC_GPIO3_PU2>;
		io-channel-names= "vph_pwr_voltage_sub";

		main-sub {
			compatible = "hw-match, main-sub";
			use_pmic_adc;
			adc_ranges = <  0 249
					250 400
					401 849
					850 1050
					1051 1179
					1180 1300
					1301 1599
					1600 1900>;
			aboard-patterns = <7 5 5 3 3 3 5 5 5 1 5 5 5 5 5>;

			/*main board*/
			match-projects = <20021 20221 20222 20223 20224 20225 20226 20227 20228 20229 20202 20203 20204 20207 20208>;
		};
	};

	//#ifdef OPLUS_FEATURE_FINGERPRINT
		fingerprint: egis {
		status = "okay";
		compatible = "egistec,et523";
		interrupt-parent = <&tlmm>;
		interrupts = <34 0x00>;
		egistec,gpio_pwr_en = <&tlmm 93 0x00>;
		//egistec,gpio_ldo1p8_en = <&tlmm 53 0x00>;
		//avdd-supply = <&pm8953_l10>;
		//vddio-supply = <&pm6125_l9>;
		egistec,gpio_rst = <&tlmm 97 0x00>;
		egistec,gpio_irq = <&tlmm 34 0x00>;
	};
	oplus_fp_common {
		compatible = "oplus,fp_common";
		oplus,fp_gpio = <1199 1200>; /* 1199 is gpio32 value,1200 is gpio33 value */
		pinctrl-names = "default";
		pinctrl-0 = <&gpio_id1_default &gpio_id2_default>;

		egis {
			oplus,fp-id = <1 0>; /* fp id mapping table */
			vendor-chip = <18>; /* please refer to the struct fp_vendor_t in oppo_fp_commmon.n */
			eng-menu = "-1,-1"; /* represents SNR, inclination test item in engineer menu, and 0/1 means off/on */
			chip-name = "E_et520";  /* /proc/fp_id, will be displayed in engineer menu  */
		};
		silead_fp {
			oplus,fp-id = <0 0>; /* fp id mapping table */
			vendor-chip = <13>; /* please refer to the struct fp_vendor_t in oppo_fp_commmon.n */
			eng-menu = "-1,-1"; /* represents SNR, inclination test item in engineer menu, and 0/1 means off/on */
			chip-name = "S_gsl6150";  /* /proc/fp_id, will be displayed in engineer menu  */
		};
		cdfinger {
			oplus,fp-id = <1 1>; /* fp id mapping table */
			vendor-chip = <19>; /* please refer to the struct fp_vendor_t in oppo_fp_commmon.n */
			eng-menu = "-1,-1"; /* represents SNR, inclination test item in engineer menu, and 0/1 means off/on */
			chip-name = "F_fps980s";  /* /proc/fp_id, will be displayed in engineer menu  */
		};
		goodix {
			oplus,fp-id = <0 1>; /* fp id mapping table */
			vendor-chip = <20>; /* please refer to the struct fp_vendor_t in oppo_fp_commmon.n */
			eng-menu = "-1,-1"; /* represents SNR, inclination test item in engineer menu, and 0/1 means off/on */
			chip-name = "G_3688";  /* /proc/fp_id, will be displayed in engineer menu  */
		};
		goodix_optical_G3S {
			oplus,fp-id = <1>; /* fp id mapping table */
			vendor-chip = <11>; /* please refer to the struct fp_vendor_t in oppo_fp_commmon.n */
			eng-menu = "-1,-1"; /* represents SNR, inclination test item in engineer menu, and 0/1 means off/on */
			chip-name = "G_OPTICAL_G3S";  /* /proc/fp_id, will be displayed in engineer menu  */
		};
	};
	silead_fp {
		status = "okay";
		compatible = "sil,silead_fp";
		qcom,qup-id = <5>;
		interrupt-parent = <&tlmm>;
		interrupts = <34 0x00>;
		avdd-gpios = <&tlmm 93 0x00>;
		rst-gpios  = <&tlmm 97 0x00>;
		irq-gpios  = <&tlmm 34 0x00>;
	};
	cdfinger_fingerprint {
        	compatible = "cdfinger,fingerprint";
		interrupt-parent = <&tlmm>;
		interrupts = <34 0x0>;
		cdfinger,reset_gpio = <&tlmm 97 0>;
		cdfinger,irq_gpio = <&tlmm 34 0>;
        	cdfinger,pwr_gpio = <&tlmm 93 0>;
		//vdd-supply = <&pm8937_l6>;
	};
	goodix_fp {
		compatible = "goodix,goodix_fp_gf3626";
		interrupt-parent = <&tlmm>;
		interrupts = <34 0>;
		goodix,gpio_irq = <&tlmm 34 0x0>;
		goodix,gpio_reset = <&tlmm 97 0x0>;
		goodix,gpio_pwr = <&tlmm 93 0x0>;
		pinctrl-names = "default";
		pinctrl-0 = <&gpio_goodix_irq_default>;
	};
        //#endif /*OPLUS_FEATURE_FINGERPRINT*/
	/* ZhaoGen, 2020/01/13, Add for TP Bringup*/
        /delete-node/ qupv3_se2_i2c;
	qupv3_se2_spi: spi@4a88000 {
		compatible = "qcom,spi-geni";
		#address-cells = <1>;
		#size-cells = <0>;
		reg = <0x4a88000 0x4000>;
		reg-names = "se_phys";
		clock-names = "se-clk", "m-ahb", "s-ahb";
		clocks = <&gcc GCC_QUPV3_WRAP0_S2_CLK>,
		<&gcc GCC_QUPV3_WRAP_0_M_AHB_CLK>,
		<&gcc GCC_QUPV3_WRAP_0_S_AHB_CLK>;
		pinctrl-names = "default", "sleep";
		pinctrl-0 = <&qupv3_se2_spi_active &qupv3_se2_spi_miso_active &qupv3_se2_spi_cs_active>;
		pinctrl-1 = <&qupv3_se2_spi_sleep &qupv3_se2_spi_miso_sleep &qupv3_se2_spi_cs_sleep>;

		interrupts = <GIC_SPI 329 IRQ_TYPE_LEVEL_HIGH>;
		spi-max-frequency = <50000000>;
		qcom,wrapper-core = <&qupv3_0>;
		dmas = <&gpi_dma0 0 2 1 64 0>,
		<&gpi_dma0 1 2 1 64 0>;
		dma-names = "tx", "rx";
		status = "disabled";
	};

    // #ifdef OPLUS_FEATURE_SECURITY_COMMON
    oplus_secure_common {
        compatible = "oplus,secure_common";
    };
    //#endif /* OPLUS_FEATURE_SECURITY_COMMON */

	//#ifdef OPLUS_FEATRUE_SIM_HOLDER_DETECT
	oplus_sim_detect {
		compatible = "oplus, sim_detect";
		Hw,sim_det = "modem_det";
	};
	//#endif /* OPLUS_FEATRUE_SIM_HOLDER_DETECT */

	//#ifdef OPLUS_ARCH_EXTENDS
	sia81xx_L: sia81xx@L {
			compatible = "si,sia81xx";
			si,sia81xx_type = "sia8109";
			si,sia81xx_reset = <&tlmm 98 0x00>;
			si,sia81xx_owi = <&tlmm 98 0x00>;
			pinctrl-names = "sia81xx_gpio";
			pinctrl-0 = <&sia81xx_gpio_L>;

			si,sia81xx_disable_pin = <1>;

			/* the same value share a same task
			 * valid value range : 0 ~ 7 */
			timer_task_hdl = <0>;

			channel_num = <0>;
			owi_mode = <6>;
			en_x_filter = <1>;
			en_dynamic_updata_vdd = <1>;
			dynamic_updata_vdd_port = <0xb030>;
	};

	sia81xx_R: sia81xx@R {
			compatible = "si,sia81xx";
			si,sia81xx_type = "sia8109";
			si,sia81xx_reset = <&tlmm 107 0x00>;
			si,sia81xx_owi = <&tlmm 107 0x00>;
			pinctrl-names = "sia81xx_gpio";
			pinctrl-0 = <&sia81xx_gpio_R>;

			si,sia81xx_disable_pin = <1>;

			/* the same value share a same task
			 * valid value range : 0 ~ 7 */
			timer_task_hdl = <0>;

			channel_num = <1>;
			owi_mode = <6>;
			en_x_filter = <0>;
			en_dynamic_updata_vdd = <1>;
			dynamic_updata_vdd_port = <0xb030>;
	};
	//#endif /* OPLUS_ARCH_EXTENDS */

	//#ifdef VENDOR_EDIT
	oplus_rf_cable {
		compatible = "oplus,rf_cable";
		interrupt-parent = <&tlmm>;
		rf_cable_support_num = <1>;
		rf,cable0-gpio = <&tlmm 39 0>;
		rf,cable-support-timer = <0>;
		pinctrl-names = "rf_cable_active";
		pinctrl-0 = <&rf_cable0_active>;
	};
	//#endif /* VENDOR_EDIT */
	
	//#ifdef OPLUS_FEATURE_THERMAL_HORAE
	shell_front {
		compatible = "oplus,shell-temp";
	};

	shell_frame {
		compatible = "oplus,shell-temp";
	};

	shell_back {
		compatible = "oplus,shell-temp";
	};
	//#endif /* OPLUS_FEATURE_THERMAL_HORAE */
	adsp_loader: qcom,msm-adsp-loader {
		status = "ok";
		compatible = "qcom,adsp-loader";
		qcom,adsp-state = <0>;
		//#ifdef VENDOR_EDIT
		adsp-firmware = "adsp2_v1";
		pinctrl-names = "default";
		pinctrl-0 = <&adsp_accel_gpio &adsp_prox_gpio>;
		adsp-accel-gpio = <&tlmm 84 0>;
		adsp-prox-gpio = <&tlmm 82 0>;
		//#endif//VENDOR_EDIT
	};
};
&spmi_bus {
	qcom,pm6125@0 {
		qcom,power-on@800 {
			qcom,pmicwd;
			qcom,pon_2 {
				qcom,pon-type = <1>;
				qcom,pull-up = <1>;
				linux,code = <KEY_VOLUMEUP>;
			};
		};
		pm6125_vadc: vadc@3100 {
			compatible = "qcom,spmi-adc5_soda_rum";
			pinctrl-0 = <&usb_temp1_default &usb_temp2_default &camera_therm_default &emmc_therm_default>;
			usb_temp1 {
				reg = <ADC_GPIO1_PU2>;
				label = "usb_temp1";
				qcom,ratiometric;
				qcom,hw-settle-time = <200>;
				qcom,pre-scaling = <1 1>;
				qcom,scale-fn-type = <ADC_SCALE_HW_CALIB_DEFAULT>;
			};
			usb_temp2 {
				reg = <ADC_GPIO2_PU2>;
				label = "usb_temp2";
				qcom,ratiometric;
				qcom,hw-settle-time = <200>;
				qcom,pre-scaling = <1 1>;
				qcom,scale-fn-type = <ADC_SCALE_HW_CALIB_DEFAULT>;
			};
			camera_flash_therm {
				/*#ifdef ODM_HQ_EDIT*/
				reg = <ADC_GPIO4_PU2>;
				label = "camera_flash_therm";
				qcom,ratiometric;
				qcom,hw-settle-time = <200>;
				qcom,pre-scaling = <1 1>;
			};
			/*#ifdef ODM_HQ_EDIT*/
			cpu_ufs_therm {
				reg = <ADC_GPIO3_PU2>;
				label = "cpu_ufs_therm";
				qcom,ratiometric;
				qcom,hw-settle-time = <200>;
				qcom,pre-scaling = <1 1>;
				qcom,scale-fn-type = <6>;
			};
		};
    };

	//#ifdef ODM_HQ_EDIT
	pmi632_3: qcom,pmi632@3 {
		pmi632_lcdb: qpnp-lcdb@ec00 {
			qcom,pwrdn-delay-ms = <4>; //Possible values are 0, 1, 4, 8.
			lcdb_ldo_vreg: ldo {
				qcom,ldo-voltage-mv = <6000>;
			};
			lcdb_ncp_vreg: ncp {
				qcom,ldo-voltage-mv = <6000>;
			};
		};
	};
	//#endif /* ODM_HQ_EDIT */
};
	&pmi632_vadc {
		compatible = "qcom,spmi-adc5-lite_soda_rum";
		pinctrl-0 = <&conn_therm_default &skin_therm_default &sub_id_default>;
			bat_therm {
			    reg = <ADC_BAT_THERM_PU1>;
		            qcom,lut-index = <2>;
			};
	//#ifdef ODM_HQ_EDIT
        sub_id {
                reg = <ADC_GPIO3_PU2>;
                lab = "sub_id";
                qcom,ratiometric;
                qcom,hw-settle-time = <200>;
                qcom,pre-scaling = <1 1>;
        };
	//#endif
	};
	&pmi632_qg {
		    io-channels = <&pmi632_vadc ADC_BAT_THERM_PU1>,
		    		  <&pmi632_vadc ADC_PARALLEL_ISENSE>,
		                  <&pmi632_vadc ADC_BAT_ID_PU2>;
	        io-channel-names = "batt-therm",
		                       "parallel_isense",
		                       "batt-id";
			qcom,shutdown_soc_threshold = <50>;
		    qcom,qg-iterm-ma = <430>;
		    qcom,s3-entry-ibat-ua = <25000>;
		    qcom,s3-exit-ibat-ua = <38000>;
		    qcom,vbatt-cutoff-mv = <3390>;
		    qcom,fvss-enable;
			qcom,project-index = <0>;// soda = 0; rum = 1; coco = 2
		    qcom,enable-qpnp-qg;
	};


&pmi632_gpios {
	//#ifdef ODM_HQ_EDIT
        sub_id {
                sub_id_default: sub_id_default {
                        pins = "gpio4";
                        function = "normal";
                        bias-high-impedance;
                        bias-disable;
                };
        };
	//#endif
};

&pmi632_adc_tm {
	//#ifdef ODM_HQ_EDIT
	io-channels = <&pmi632_vadc ADC_GPIO2_PU2>,
			<&pmi632_vadc ADC_GPIO3_PU2>;
	//#endif
	//#ifdef ODM_HQ_EDIT
	sub_id {
                reg = <ADC_GPIO3_PU2>;
                qcom,ratiometric;
                qcom,hw-settle-time = <200>;
        };
	//#endif
};

&pm6125_gpios {
	camera_therm {
		camera_therm_default: camera_therm_default {
			/*#ifdef ODM_HQ_EDIT*/
			pins = "gpio7";
			bias-high-impedance;
		};
	};

	emmc_therm {
		emmc_therm_default: emmc_therm_default {
			/*#ifdef ODM_HQ_EDIT*/
			pins = "gpio6";
			bias-high-impedance;
		};
	};
};

&spmi_bus {
	qcom,pm6125@0 {
		pm6125_adc_tm_iio: adc_tm@3400 {
			compatible = "qcom,adc-tm5-iio";
			reg = <0x3400 0x100>;
			#thermal-sensor-cells = <1>;
			#address-cells = <1>;
			#size-cells = <0>;
			/*#ifdef ODM_HQ_EDIT*/
			/delete-property/ io-channels;
			io-channels = <&pm6125_vadc ADC_GPIO4_PU2>,
					<&pm6125_vadc ADC_GPIO3_PU2>;
			camera_flash_therm {
				/*#ifdef ODM_HQ_EDIT*/
				reg = <ADC_GPIO4_PU2>;
				qcom,ratiometric;
				qcom,hw-settle-time = <200>;
			};

			/*#ifdef ODM_HQ_EDIT*/
			emmc_ufs_therm {
				reg = <ADC_GPIO3_PU2>;
				qcom,ratiometric;
				qcom,hw-settle-time = <200>;
			};
		};
	};
};

&pmi632_vadc {
	skin_therm {
		qcom,scale-fn-type = <6>;
	};
};

&pm6125_adc_tm {
	io-channels = <&pm6125_vadc ADC_AMUX_THM1_PU2>,
			<&pm6125_vadc ADC_AMUX_THM2_PU2>,
			<&pm6125_vadc ADC_XO_THERM_PU2>;
};

&thermal_zones {
	cpu-therm-usr {
		polling-delay-passive = <0>;
		polling-delay = <0>;
		thermal-governor = "user_space";
		thermal-sensors = <&pm6125_adc_tm_iio ADC_GPIO3_PU2>;
		wake-capable-sensor;
		trips {
			active-config0 {
				temperature = <125000>;
				hysteresis = <1000>;
				type = "passive";
			};
		};
	};

	camera-therm-usr {
		/delete-property/ thermal-sensors;
		thermal-sensors = <&pm6125_adc_tm_iio ADC_GPIO4_PU2>;
	};

	emmc-ufs-therm-usr{
		status = "disabled";
	};
};

/* increase the trigger temp */
&skin_gold_trip {
	temperature = <80000>;
};

&skin_silver_trip {
	temperature = <81000>;
};

&skin_gpu_trip {
	temperature = <83000>;
};

&qusb_phy0 {
	qcom,qusb-phy-init-seq = <0xf8 0x80
				0xb3 0x84
				0x81 0x88
				0xc7 0x8c
				0x30 0x08
				0x79 0x0c
				0x21 0x10
				0x14 0x9c
				0x80 0x04
				0x9f 0x1c
				0x00 0x18>;
	qcom,tune2-efuse-correction = <(-3)>;
};
&tlmm {
	fpc_reset_int: fpc_reset_int {
		fpc_reset_low: reset_low {
			mux {
				pins = "gpio97";
				function = "gpio";
			};

			config {
				pins = "gpio97";
				drive-strength = <2>;
				bias-disable;
				output-low;
			};
		};

		fpc_reset_high: reset_high {
			mux {
				pins = "gpio97";
				function = "gpio";
			};

			config {
				pins = "gpio97";
				drive-strength = <2>;
				bias-disable;
				output-high;
			};
		};

		fpc_int_low: int_low {
			mux {
				pins = "gpio34";
				function = "gpio";
			};

			config {
				pins = "gpio34";
				drive-strength = <2>;
				bias-pull-down;
				input-enable;
			};
		};
	};
		pmx_sde: pmx_sde {
			sde_dsi_active: sde_dsi_active {
				mux {
					pins = "gpio85";
					function = "gpio";
				};

				config {
					pins = "gpio85";
					drive-strength = <8>;
					bias-disable = <0>;
				};
			};

			sde_dsi_suspend: sde_dsi_suspend {
				mux {
					pins = "gpio85";
					function = "gpio";
				};

				config {
					pins = "gpio85";
					drive-strength = <2>;
					bias-pull-down;
				};
			};
		};

		pmx_sde_te {
			sde_te_active: sde_te_active {
				mux {
					pins = "gpio81";
					function = "mdp_vsync";
				};

				config {
					pins = "gpio81";
					drive-strength = <2>;
					bias-pull-down;
				};
			};

			sde_te_suspend: sde_te_suspend {
				mux {
					pins = "gpio81";
					function = "mdp_vsync";
				};

				config {
					pins = "gpio81";
					drive-strength = <2>;
					bias-pull-down;
				};
			};
		};

	pmx_aw_spk_rst_active {
		aw_spk_reset_on: aw_spk_reset_on {
			mux {
				pins = "gpio98";
				function = "gpio";
			};

			config {
				pins = "gpio98";
				drive-strength = <8>;
				bias-pull-up;
			};
		};

		aw_spk_reset_off: aw_spk_reset_off {
			mux {
				pins = "gpio98";
				function = "gpio";
			};

			config {
				pins = "gpio98";
				drive-strength = <2>;
				bias-pull-down;
			};
		};
	};

	pmx_aw_rcv_rst_active {
		aw_rcv_reset_on: aw_rcv_reset_on {
			mux {
				pins = "gpio107";
				function = "gpio";
			};

			config {
				pins = "gpio107";
				drive-strength = <8>;
				bias-pull-up;
			};
		};

		aw_rcv_reset_off: aw_rcv_reset_off {
			mux {
				pins = "gpio107";
				function = "gpio";
			};

			config {
				pins = "gpio107";
				drive-strength = <2>;
				bias-pull-down;
			};
		};
	};

	//#ifdef OPLUS_FEATURE_FINGERPRINT
	oplus_fp_common{
	        gpio_id1_default: gpio_id1_default {
			mux {
				pins = "gpio32";
				function = "gpio";
			};
				config {
					pins = "gpio32";
					drive-strength = <2>;
					bias-pull-up;
					input-enable;
				};
			};
		gpio_id2_default: gpio_id2_default {
			mux {
				pins = "gpio33";
				function = "gpio";
			};
			config {
				pins = "gpio33";
				drive-strength = <2>;
				bias-pull-up;
				input-enable;
			};
		};
	};

	goodix_fp{
		gpio_goodix_irq_default: gpio_goodix_irq_default {
			mux {
				pins = "gpio34";
				function = "gpio";
			};
			config {
				pins = "gpio34";
				drive-strength = <2>;
				bias-disable;
				input-enable;
			};
		};
	};
	//#endif /*OPLUS_FEATURE_FINGERPRINT*/

	//#ifdef OPLUS_ARCH_EXTENDS
	sia81xx_gpio_L: sia81xx_gpio_L {
		mux {
			pins = "gpio98", "gpio98";
			function = "gpio";
		};

		config {
			pins = "gpio98", "gpio98";
			drive-strength = <6>;
			bias-disable;
		};
	};

	sia81xx_gpio_R: sia81xx_gpio_R {
		mux {
			pins = "gpio107", "gpio107";
			function = "gpio";
		};

		config {
			pins = "gpio107", "gpio107";
			drive-strength = <6>;
			bias-disable;
		};
	};
	//#endif /* OPLUS_ARCH_EXTENDS */

	//#ifdef VENDOR_EDIT
	rf_cable0_active: rf_cable0_active {
		mux {
			pins = "gpio106";
			function = "gpio";
		};
		config {
			pins = "gpio106";
			drive-strength = <2>;
			input-enable;
			bias-pull-up;
		};
	};
	//#endif /* VENDOR_EDIT */
	/* ZhaoGen, 2020/01/13, Add for TP Bringup*/
        /delete-node/ qupv3_se2_i2c_pins;
	qupv3_se2_spi_pins: qupv3_se2_spi_pins {
		qupv3_se2_spi_active: qupv3_se2_spi_active {
			mux {
				pins = "gpio7", "gpio71";
				function = "qup2";
			};

			config {
				pins = "gpio7", "gpio71";
				drive-strength = <8>;
				bias-pull-down;
			};
		};

		qupv3_se2_spi_sleep: qupv3_se2_spi_sleep {
			mux {
				pins = "gpio7", "gpio71";
				function = "qup2";
			};

			config {
				pins = "gpio7", "gpio71";
				drive-strength = <8>;
				bias-pull-down;
			};
		};
	};

	qupv3_se2_spi_cs_pin: qupv3_se2_spi_cs_pin {
		qupv3_se2_spi_cs_active: qupv3_se2_spi_cs_active {
			mux {
				pins = "gpio80";
				function = "qup2";
			};

			config {
				pins = "gpio80";
				drive-strength = <8>;
				output-high;
				bias-pull-up;
			};
		};

		qupv3_se2_spi_cs_sleep: qupv3_se2_spi_cs_sleep {
			mux {
				pins = "gpio80";
				function = "qup2";
			};

			config {
				pins = "gpio80";
				drive-strength = <8>;
				output-high;
				bias-pull-up;
			};
		};
	};

	qupv3_se2_spi_miso_pin: qupv3_se2_spi_miso_pin {
		qupv3_se2_spi_miso_active: qupv3_se2_spi_miso_active {
			mux {
				pins = "gpio6";
				function = "qup2";
			};

			config {
				pins = "gpio6";
				drive-strength = <8>;
				bias-pull-down;
			};
		};

		qupv3_se2_spi_miso_sleep: qupv3_se2_spi_miso_sleep {
			mux {
				pins = "gpio6";
				function = "qup2";
			};

			configs {
				pins = "gpio6";
				drive-strength = <8>;
				bias-pull-down;
			};
		};
	};

	pmx_ts_int_active {
		ts_int_active: ts_int_active {
			mux {
				pins = "gpio104";
				function = "gpio";
			};

			config {
				pins = "gpio104";
				drive-strength = <8>;
				bias-pull-up;
			};
		};
	};

	pmx_ts_int_suspend {
		ts_int_suspend: ts_int_suspend {
			mux {
				pins = "gpio104";
				function = "gpio";
			};

			config {
				pins = "gpio104";
				drive-strength = <2>;
				bias-pull-up;
			};
		};
	};

	pmx_ts_reset_active {
		ts_reset_active: ts_reset_active {
			mux {
				pins = "gpio103";
				function = "gpio";
			};

			config {
				pins = "gpio103";
				drive-strength = <8>;
				bias-pull-up;
			};
		};
	};

	pmx_ts_reset_suspend {
		ts_reset_suspend: ts_reset_suspend {
			mux {
				pins = "gpio103";
				function = "gpio";
			};

			config {
				pins = "gpio103";
				drive-strength = <2>;
				bias-pull-down;
			};
		};
	};

	pmx_ts_release {
		ts_release: ts_release {
			mux {
				pins = "gpio103", "gpio104";
				function = "gpio";
			};

			config {
				pins = "gpio103", "gpio104";
				drive-strength = <2>;
				bias-pull-down;
			};
		};
	};
};

&firmware {
	android {
		fstab {
			vendor {
				/delete-property/ fsmgr_flags;
				fsmgr_flags = "wait,avb";
			};
		};
	};
};

&L6P {
	/delete-property/ regulator-min-microvolt;
	/delete-property/ regulator-max-microvolt;
	regulator-min-microvolt = <2800000>;
	regulator-max-microvolt = <3400000>;
};

&bengal_snd {
	/delete-property/ qcom,wsa-max-devs;
	/delete-property/ qcom,wsa-devs;
	qcom,wsa-max-devs = <0>;
	qcom,wsa-devs = <0>;

	si,sia81xx-max-num = <2>;
	si,sia81xx-aux-devs = <&sia81xx_L>, <&sia81xx_R>;
	si,sia81xx-aux-devs-prefix = "SpkrMonoL", "SpkrMonoR";
};

&qupv3_se1_i2c {
	/delete-node/ nq;

	aw87xxx_pa_58@58{
		compatible = "awinic,aw87xxx_pa_58";
		reg = <0x58>;

		pa-channel = < 0 >;
		/* actflag-gain-array: off music voice fm rcv */
		actflag-gain-array = < 0x00 0x08 0x08 0x08 0x00 >;
		/*actflag-auto-run;*/
		gain-reg-addr = <0x06>;
		monitor-flag = <1>;
		monitor-timer-val = <3000>;
		monitor-timer-count-max = <5>;

		aw87xxx_rst = <&tlmm 98 0x00>;
		pinctrl-names = "spk_reset_on", "spk_reset_off";
		pinctrl-0 = <&aw_spk_reset_on>;
		pinctrl-1 = <&aw_spk_reset_off>;

		status = "okay";
	};

	aw87xxx_pa_59@59{
		compatible = "awinic,aw87xxx_pa_59";
		reg = <0x59>;

		pa-channel = < 1 >;
		/* actflag-gain-array: off music voice fm rcv */
		actflag-gain-array = < 0x00 0x08 0x08 0x08 0x00 >;
		/*actflag-auto-run;*/
		gain-reg-addr = <0x06>;
		monitor-flag = <1>;
		monitor-timer-val = <3000>;
		monitor-timer-count-max = <5>;

		aw87xxx_rst = <&tlmm 107 0x00>;
		pinctrl-names = "rcv_reset_on", "rcv_reset_off";
		pinctrl-0 = <&aw_rcv_reset_on>;
		pinctrl-1 = <&aw_rcv_reset_off>;

		status = "okay";
	};
};

&sde_dsi {
	/delete-property/ qcom,dsi-default-panel;
	qcom,dsi-default-panel = <&dsi_ili9881h_boe_video>;
};
&msm_notifier {
	/delete-property/ panel;
	panel = <&dsi_s6e8fc1_samsung_video
		&dsi_s6e8fc1_samsung_video>;
};

&pm8008_9{
	status = "okay";
};

/* #ifdef OPLUS_FEATURE_EMMC_DRIVER */
&sdhc_1 {
       status = "ok";
};

&sdhc_2 {
       cd-gpios = <&tlmm 88 GPIO_ACTIVE_HIGH>;
       status = "ok";
};
/* #endif */

//bengal-audio-overlay.dtsi
&swr1 {
	/delete-property/ qcom,disable-div2-clk-switch;
};
&wcd937x_codec {
	/delete-property/ qcom,cdc-micbias2-mv;
	qcom,cdc-micbias2-mv = <2700>;
	oplus,mbhc-headset-micbias-alwayon = <1>;
};

&bengal_snd {
	/delete-property/ qcom,wsa-max-devs;
	/delete-property/ qcom,wsa-devs;
	qcom,wsa-max-devs = <0>;
	qcom,wsa-devs = <0>;
};

/*BSP.Kernel.Debug, 2019/06/22, Modify for avoid noise, change from no-pull to bias-pull-down*/
&qupv3_se4_2uart_active {
	config {
	/delete-property/ bias-disable;
	bias-pull-down;
	};
};

//bengal-camera-sensor-qrd.dtsi
&tlmm {
	cam_sensor_rear0_reset_active: cam_sensor_rear0_reset_active {
		mux {
			pins = "gpio65";
			function = "gpio";
		};
		config {
			pins = "gpio65";
			bias-disable; /* No PULL */
			drive-strength = <2>; /* 2 MA */
		};
	};
	cam_sensor_rear0_reset_suspend: cam_sensor_rear0_reset_suspend {
		mux {
			pins = "gpio65";
			function = "gpio";
		};
		config {
			pins = "gpio65";
			bias-pull-down; /* PULL DOWN */
			drive-strength = <2>; /* 2 MA */
			output-low;
		};
	};
	cam_sensor_rear1_reset_active: cam_sensor_rear1_reset_active {
		mux {
			pins = "gpio18";
			function = "gpio";
		};
		config {
			pins = "gpio18";
			bias-disable; /* No PULL */
			drive-strength = <2>; /* 2 MA */
		};
	};
	cam_sensor_rear1_reset_suspend: cam_sensor_rear1_reset_suspend {
		mux {
			pins = "gpio18";
			function = "gpio";
		};
		config {
			pins = "gpio18";
			bias-pull-down; /* PULL DOWN */
			drive-strength = <2>; /* 2 MA */
			output-low;
		};
	};
	cam_sensor_rear2_reset_active: cam_sensor_rear2_reset_active {
		mux {
			pins = "gpio24";
			function = "gpio";
		};
		config {
			pins = "gpio24";
			bias-disable; /* No PULL */
			drive-strength = <2>; /* 2 MA */
		};
	};
	cam_sensor_rear2_reset_suspend: cam_sensor_rear2_reset_suspend {
		mux {
			pins = "gpio24";
			function = "gpio";
		};
		config {
			pins = "gpio24";
			bias-pull-down; /* PULL DOWN */
			drive-strength = <2>; /* 2 MA */
			output-low;
		};
	};
	cam_sensor_front0_reset_active: cam_sensor_front0_reset_active {
		mux {
			pins = "gpio19";
			function = "gpio";
		};
		config {
			pins = "gpio19";
			bias-disable; /* No PULL */
			drive-strength = <2>; /* 2 MA */
		};
	};
	cam_sensor_front0_reset_suspend: cam_sensor_front0_reset_suspend {
		mux {
			pins = "gpio19";
			function = "gpio";
		};
		config {
			pins = "gpio19";
			bias-pull-down; /* PULL DOWN */
			drive-strength = <2>; /* 2 MA */
			output-low;
		};
	};
};

&cam_sensor_rear3_reset_active {
	mux {
		pins = "gpio18";
		function = "gpio";
	};
	config {
		pins = "gpio18";
		bias-disable; /* No PULL */
		drive-strength = <2>; /* 2 MA */
	};
};
&cam_sensor_rear3_reset_suspend {
	mux {
		pins = "gpio18";
		function = "gpio";
	};
	config {
		pins = "gpio18";
		bias-disable; /* No PULL */
		drive-strength = <2>; /* 2 MA */
	};
};
&L6P {
	regulator-min-microvolt = <1800000>;
	regulator-max-microvolt = <1800000>;
};
&cam_sensor_mclk0_active {
	/* MCLK 0*/
	mux {
		pins = "gpio20";
		function = "cam_mclk";
	};

	config {
		pins = "gpio20";
		bias-disable; /* No PULL */
		drive-strength = <4>; /* 2 MA */
	};
};
&cam_sensor_mclk0_suspend {
	/* MCLK 0*/
	mux {
		pins = "gpio20";
		function = "cam_mclk";
	};

	config {
		pins = "gpio20";
		bias-pull-down; /* PULL DOWN */
		drive-strength = <4>; /* 2 MA */
	};
};
&cam_sensor_mclk1_active {
	/* MCLK 1*/
	mux {
		pins = "gpio21";
		function = "cam_mclk";
	};

	config {
		pins = "gpio21";
		bias-disable; /* No PULL */
		drive-strength = <4>; /* 2 MA */
	};
};
&cam_sensor_mclk1_suspend {
	/* MCLK 1*/
	mux {
		pins = "gpio21";
		function = "cam_mclk";
	};

	config {
		pins = "gpio21";
		bias-pull-down; /* PULL DOWN */
		drive-strength = <4>; /* 2 MA */
	};
};
&cam_sensor_mclk2_active {
	/* MCLK 2*/
	mux {
		pins = "gpio27";
		function = "cam_mclk";
	};

	config {
		pins = "gpio27";
		bias-disable; /* No PULL */
		drive-strength = <4>; /* 2 MA */
	};
};

&cam_sensor_mclk2_suspend {
	/* MCLK 2*/
	mux {
		pins = "gpio27";
		function = "cam_mclk";
	};

	config {
		pins = "gpio27";
		bias-pull-down; /* PULL DOWN */
		drive-strength = <4>; /* 2 MA */
	};
};
&cam_sensor_mclk3_active {
	/* MCLK 3*/
	mux {
		pins = "gpio28";
		function = "cam_mclk";
	};

	config {
		pins = "gpio28";
		bias-disable; /* No PULL */
		drive-strength = <4>; /* 2 MA */
	};
};

&cam_sensor_mclk3_suspend {
	/* MCLK 3*/
	mux {
		pins = "gpio28";
		function = "cam_mclk";
	};

	config {
		pins = "gpio28";
		bias-pull-down; /* PULL DOWN */
		drive-strength = <4>; /* 2 MA */
	};
};

&cam_sensor_csi_mux_sel_active {
	/*CSIMUX_SEL*/
	mux {
		pins = "gpio67";
		function = "gpio";
	};

	config {
		pins = "gpio67";
		bias-disable; /* No PULL */
		drive-strength = <2>; /* 2 MA */
	};
};
&cam_sensor_csi_mux_sel_suspend {
	/* CSIMUX_SEL */
	mux {
		pins = "gpio67";
		function = "gpio";
	};

	config {
		pins = "gpio67";
		bias-pull-down; /* PULL DOWN */
		drive-strength = <2>; /* 2 MA */
		output-low;
	};
};

&led_flash_rear_aux {
		cell-index = <1>;
		compatible = "qcom,camera-flash";
		flash-source  = <&pmi632_flash0>;
		torch-source  = <&pmi632_torch0>;
		switch-source = <&pmi632_switch0>;
		status = "ok";
};

&eeprom_rear {
	cell-index = <0>;
	compatible = "qcom,eeprom";
	cam_vio-supply = <&L6P>;
	cam_vana-supply = <&L3P>;
	cam_vdig-supply = <&L1P>;
	cam_vaf-supply = <&L4P>;
	cam_clk-supply = <&gcc_camss_top_gdsc>;
	regulator-names = "cam_vio", "cam_vana", "cam_vdig",
		"cam_clk", "cam_vaf";
	rgltr-cntrl-support;
	pwm-switch;
	rgltr-min-voltage = <1800000 2800000 1200000 0 2800000>;
	rgltr-max-voltage = <1800000 2800000 1200000 0 2800000>;
	rgltr-load-current = <120000 80000 1200000 0 100000>;
	gpio-no-mux = <0>;
	pinctrl-names = "cam_default", "cam_suspend";
	pinctrl-0 = <&cam_sensor_mclk0_active
			&cam_sensor_rear0_reset_active>;
	pinctrl-1 = <&cam_sensor_mclk0_suspend
			&cam_sensor_rear0_reset_suspend>;
	gpios = <&tlmm 20 0>,
		<&tlmm 65 0>;
	gpio-reset = <1>;
	gpio-req-tbl-num = <0 1>;
	gpio-req-tbl-flags = <1 0>;
	gpio-req-tbl-label = "CAMIF_MCLK0",
				"CAM_RESET0";
	sensor-mode = <0>;
	cci-master = <1>;
	status = "ok";
	clocks = <&gcc GCC_CAMSS_MCLK0_CLK>;
	clock-names = "cam_clk";
	clock-cntl-level = "turbo";
	clock-rates = <24000000>;
};

&eeprom_rear_aux {
	cell-index = <1>;
	compatible = "qcom,eeprom";
	cam_vio-supply = <&L6P>;
	cam_vana-supply = <&L5P>;
	//cam_vdig-supply = <&L1P>;
	cam_vaf-supply = <&L5P>;
	cam_clk-supply = <&gcc_camss_top_gdsc>;
	regulator-names = "cam_vio", "cam_vana", "cam_clk";
	rgltr-cntrl-support;
	pwm-switch;
	rgltr-min-voltage = <1800000 2800000  0 >;
	rgltr-max-voltage = <1800000 2800000  0 >;
	rgltr-load-current = <120000 80000  0 >;
	gpio-no-mux = <0>;
	pinctrl-names = "cam_default", "cam_suspend";
	pinctrl-0 = <&cam_sensor_mclk3_active
			&cam_sensor_rear1_reset_active>;
	pinctrl-1 = <&cam_sensor_mclk3_suspend
			&cam_sensor_rear1_reset_suspend>;
	gpios = <&tlmm 28 0>,
		<&tlmm 18 0>;
	gpio-reset = <1>;
	gpio-req-tbl-num = <0 1>;
	gpio-req-tbl-flags = <1 0>;
	gpio-req-tbl-label = "CAMIF_MCLK3",
				"CAM_RESET1";
	sensor-mode = <0>;
	cci-master = <0>;
	status = "ok";
	clocks = <&gcc GCC_CAMSS_MCLK3_CLK>;
	clock-names = "cam_clk";
	clock-cntl-level = "turbo";
	clock-rates = <24000000>;
};

&eeprom_front {
	cell-index = <2>;
	compatible = "qcom,eeprom";
	cam_vio-supply = <&L6P>;
	cam_vana-supply = <&L5P>;
	cam_vdig-supply = <&L2P>;
	cam_clk-supply = <&gcc_camss_top_gdsc>;
	regulator-names = "cam_vio", "cam_vana", "cam_vdig",
		"cam_clk";
	rgltr-cntrl-support;
	pwm-switch;
	rgltr-min-voltage = <1800000 2800000 1060000 0>;
	rgltr-max-voltage = <1800000 2800000 1200000 0>;
	rgltr-load-current = <0 80000 105000 0>;
	gpio-no-mux = <0>;
	pinctrl-names = "cam_default", "cam_suspend";
	pinctrl-0 = <&cam_sensor_mclk1_active
			&cam_sensor_front0_reset_active>;
	pinctrl-1 = <&cam_sensor_mclk1_suspend
			&cam_sensor_front0_reset_suspend>;
	gpios = <&tlmm 21 0>,
		<&tlmm 19 0>;
	gpio-reset = <1>;
	gpio-req-tbl-num = <0 1>;
	gpio-req-tbl-flags = <1 0>;
	gpio-req-tbl-label = "CAMIF_MCLK1",
				"CAM_RESET2";
	sensor-mode = <0>;
	cci-master = <1>;
	status = "ok";
	clocks = <&gcc GCC_CAMSS_MCLK1_CLK>;
	clock-names = "cam_clk";
	clock-cntl-level = "turbo";
	clock-rates = <24000000>;
};

&eeprom_rear_aux2 {
	cell-index = <3>;
	compatible = "qcom,eeprom";
	cam_vio-supply = <&L6P>;
	cam_vana-supply = <&L5P>;
	//cam_vdig-supply = <&L1P>;
	cam_clk-supply = <&gcc_camss_top_gdsc>;
	regulator-names = "cam_vio", "cam_vana", "cam_clk";
	rgltr-cntrl-support;
	pwm-switch;
	rgltr-min-voltage = <1800000 2800000  0>;
	rgltr-max-voltage = <1800000 2800000  0>;
	rgltr-load-current = <120000 80000  0>;
	gpio-no-mux = <0>;
	pinctrl-names = "cam_default", "cam_suspend";
	pinctrl-0 = <&cam_sensor_mclk2_active
			&cam_sensor_rear2_reset_active>;
	pinctrl-1 = <&cam_sensor_mclk2_suspend
			&cam_sensor_rear2_reset_suspend>;
	gpios = <&tlmm 27 0>,
		<&tlmm 24 0>;
	gpio-reset = <1>;
	gpio-req-tbl-num = <0 1>;
	gpio-req-tbl-flags = <1 0>;
	gpio-req-tbl-label = "CAMIF_MCLK2",
				"CAM_RESET3";
	sensor-mode = <0>;
	cci-master = <1>;
	status = "ok";
	clocks = <&gcc GCC_CAMSS_MCLK2_CLK>;
	clock-names = "cam_clk";
	clock-cntl-level = "turbo";
	clock-rates = <24000000>;
};

&eeprom_rear_aux3 {
	/delete-property/ cam_vio-supply;
	/delete-property/ pinctrl-0;
	/delete-property/ pinctrl-1;
	/delete-property/ gpios;
	/delete-property/ gpio-req-tbl-label;
	/delete-property/ clocks;
	/delete-property/ cci-master;
	cam_vio-supply = <&L6P>;
	pinctrl-0 = <&cam_sensor_mclk2_active
				&cam_sensor_rear3_reset_active>;
	pinctrl-1 = <&cam_sensor_mclk2_suspend
				&cam_sensor_rear3_reset_suspend>;
	gpios = <&tlmm 27 0>,
			<&tlmm 18 0>;
	gpio-req-tbl-label = "CAMIF_MCLK2",
						"CAM_RESET4";
	cci-master = <1>;
	clocks = <&gcc GCC_CAMSS_MCLK2_CLK>;
};

&actuator_rear {
	cell-index = <0>;
	compatible = "qcom,actuator";
	cci-master = <1>;
	cam_vaf-supply = <&L4P>;
	regulator-names = "cam_vaf";
	rgltr-cntrl-support;
	rgltr-min-voltage = <2800000>;
	rgltr-max-voltage = <2800000>;
	rgltr-load-current = <100000>;
	status = "ok";
};

&cam_cci0 {
    /* Rear*/
	qcom,cam-sensor0 {
		cell-index = <0>;
		compatible = "qcom,cam-sensor";
		csiphy-sd-index = <0>;
		sensor-position-roll = <90>;
		sensor-position-pitch = <0>;
		sensor-position-yaw = <180>;
		actuator-src = <&actuator_rear>;
		led-flash-src = <&led_flash_rear>;
		eeprom-src = <&eeprom_rear>;
		cam_vio-supply = <&L6P>;
		cam_vana-supply = <&L3P>;
		cam_vdig-supply = <&L1P>;
		cam_vaf-supply = <&L4P>;
		cam_clk-supply = <&gcc_camss_top_gdsc>;
		regulator-names = "cam_vio", "cam_vana", "cam_vdig",
			"cam_clk", "cam_vaf";
		rgltr-cntrl-support;
		pwm-switch;
		rgltr-min-voltage = <1800000 2800000 1200000 0 2800000>;
		rgltr-max-voltage = <1800000 2800000 1200000 0 2800000>;
		rgltr-load-current = <120000 80000 1200000 0 100000>;
		gpio-no-mux = <0>;
		pinctrl-names = "cam_default", "cam_suspend";
		pinctrl-0 = <&cam_sensor_mclk0_active
				&cam_sensor_rear0_reset_active>;
		pinctrl-1 = <&cam_sensor_mclk0_suspend
				&cam_sensor_rear0_reset_suspend>;
		gpios = <&tlmm 20 0>,
			<&tlmm 65 0>;
		gpio-reset = <1>;
		gpio-req-tbl-num = <0 1>;
		gpio-req-tbl-flags = <1 0>;
		gpio-req-tbl-label = "CAMIF_MCLK0",
					"CAM_RESET0";
		sensor-mode = <0>;
		cci-master = <1>;
		status = "ok";
		clocks = <&gcc GCC_CAMSS_MCLK0_CLK>;
		clock-names = "cam_clk";
		clock-cntl-level = "turbo";
		clock-rates = <24000000>;
	};

    /*Rear Aux Mono*/
	qcom,cam-sensor1 {
		cell-index = <1>;
		compatible = "qcom,cam-sensor";
		csiphy-sd-index = <2>;
		sensor-position-roll = <90>;
		sensor-position-pitch = <0>;
		sensor-position-yaw = <180>;
		//actuator-src = <&actuator_rear_aux>;
		//led-flash-src = <&led_flash_rear_aux>;
		eeprom-src = <&eeprom_rear_aux>;
		cam_vio-supply = <&L6P>;
		cam_vana-supply = <&L5P>;
		//cam_vdig-supply = <&L1P>;
		//cam_vaf-supply = <&L5P>;
		cam_clk-supply = <&gcc_camss_top_gdsc>;
		regulator-names = "cam_vio", "cam_vana", "cam_clk";
		rgltr-cntrl-support;
		pwm-switch;
		rgltr-min-voltage = <1800000 2800000 0>;
		rgltr-max-voltage = <1800000 2800000 0>;
		rgltr-load-current = <120000 80000 0>;
		gpio-no-mux = <0>;
		pinctrl-names = "cam_default", "cam_suspend";
		pinctrl-0 = <&cam_sensor_mclk3_active
				&cam_sensor_rear1_reset_active>;
		pinctrl-1 = <&cam_sensor_mclk3_suspend
				&cam_sensor_rear1_reset_suspend>;
		gpios = <&tlmm 28 0>,
			<&tlmm 18 0>;
		gpio-reset = <1>;
		gpio-req-tbl-num = <0 1>;
		gpio-req-tbl-flags = <1 0>;
		gpio-req-tbl-label = "CAMIF_MCLK3",
					"CAM_RESET1";
		sensor-mode = <0>;
		cci-master = <0>;
		status = "ok";
		clocks = <&gcc GCC_CAMSS_MCLK3_CLK>;
		clock-names = "cam_clk";
		clock-cntl-level = "turbo";
		clock-rates = <24000000>;
	};

    /*Front*/
	qcom,cam-sensor2 {
        	cell-index = <2>;
		compatible = "qcom,cam-sensor";
		csiphy-sd-index = <1>;
		sensor-position-roll = <270>;
		sensor-position-pitch = <0>;
		sensor-position-yaw = <0>;
		eeprom-src = <&eeprom_front>;
		cam_vio-supply = <&L6P>;
		cam_vana-supply = <&L5P>;
		cam_vdig-supply = <&L2P>;
		cam_clk-supply = <&gcc_camss_top_gdsc>;
		regulator-names = "cam_vio", "cam_vana", "cam_vdig",
			"cam_clk";
		rgltr-cntrl-support;
		pwm-switch;
		rgltr-min-voltage = <1800000 2800000 1060000 0>;
		rgltr-max-voltage = <1800000 2800000 1200000 0>;
		rgltr-load-current = <0 80000 105000 0>;
		gpio-no-mux = <0>;
		pinctrl-names = "cam_default", "cam_suspend";
		pinctrl-0 = <&cam_sensor_mclk1_active
				&cam_sensor_front0_reset_active>;
		pinctrl-1 = <&cam_sensor_mclk1_suspend
				&cam_sensor_front0_reset_suspend>;
		gpios = <&tlmm 21 0>,
			<&tlmm 19 0>;
		gpio-reset = <1>;
		gpio-req-tbl-num = <0 1>;
		gpio-req-tbl-flags = <1 0>;
		gpio-req-tbl-label = "CAMIF_MCLK1",
					"CAM_RESET2";
		sensor-mode = <0>;
		cci-master = <1>;
		status = "ok";
		clocks = <&gcc GCC_CAMSS_MCLK1_CLK>;
		clock-names = "cam_clk";
		clock-cntl-level = "turbo";
		clock-rates = <24000000>;
	};

    /*Rear Aux2 Micro*/
	qcom,cam-sensor3 {
		cell-index = <3>;
		compatible = "qcom,cam-sensor";
		csiphy-sd-index = <2>;
		sensor-position-roll = <90>;
		sensor-position-pitch = <0>;
		sensor-position-yaw = <180>;
		led-flash-src = <&led_flash_rear_aux>;
		eeprom-src = <&eeprom_rear_aux2>;
		cam_vio-supply = <&L6P>;
		cam_vana-supply = <&L5P>;
		//cam_vdig-supply = <&L1P>;
		cam_clk-supply = <&gcc_camss_top_gdsc>;
		regulator-names = "cam_vio", "cam_vana", "cam_clk";
		rgltr-cntrl-support;
		pwm-switch;
		rgltr-min-voltage = <1800000 2800000 0>;
		rgltr-max-voltage = <1800000 2800000 0>;
		rgltr-load-current = <120000 80000 0>;
		gpio-no-mux = <0>;
		pinctrl-names = "cam_default", "cam_suspend";
		pinctrl-0 = <&cam_sensor_mclk2_active
				&cam_sensor_rear2_reset_active
				&cam_sensor_csi_mux_sel_active>;
		pinctrl-1 = <&cam_sensor_mclk2_suspend
				&cam_sensor_rear2_reset_suspend
				&cam_sensor_csi_mux_sel_suspend>;
		gpios = <&tlmm 27 0>,
			<&tlmm 24 0>,
			<&tlmm 67 0>;
		gpio-reset = <1>;
		gpio-custom1 = <2>;
		gpio-req-tbl-num = <0 1 2>;
		gpio-req-tbl-flags = <1 0 0>;
		gpio-req-tbl-label = "CAMIF_MCLK2",
					"CAM_RESET3",
					"CAM_CSIMUX_SEL1";
		sensor-mode = <0>;
		cci-master = <1>;
		status = "ok";
		clocks = <&gcc GCC_CAMSS_MCLK2_CLK>;
		clock-names = "cam_clk";
		clock-cntl-level = "turbo";
		clock-rates = <24000000>;
	};

};

//modify bark time to 20s
&wdog {
	/delete-property/ qcom,bark-time;
	qcom,bark-time = <20000>;
};

&L7P {
	regulator-min-microvolt = <3300000>;
	regulator-max-microvolt = <3300000>;
	regulator-always-on;
};
/* ZhaoGen, 2020/01/13, Add for TP Bringup*/
&qupv3_se2_spi {
	/* Himax device tree node */
	status = "ok";
	ilitek_spi@0 {
		compatible = "tchip,ilitek";
		reg = <0>;
		chip-name = "NF_ILI9881H";
		status = "ok";

		spi-max-frequency = <12000000>;    //4800000,9600000,15000000,19200000
		reset-gpio = <&tlmm 103 0x00>;
		interrupt-parent = <&tlmm>;
		interrupts = <104 0x0>;
		irq-gpio = <&tlmm 104 0x2002>;

		touchpanel,irq_need_dev_resume_time = <500>;
		touchpanel,max-num-support = <10>;
		touchpanel,tx-rx-num = <18 32>;
		touchpanel,panel-coords = <720 1600>;
		touchpanel,display-coords = <720 1600>;
		touchpanel,touchmajor-limit = <0 54>;

		platform_support_project = <20221 20222 20223 20224 20225 20226 20227 20228 20229 20021 20202 20203 20204 20207 20208>;
		platform_support_project_dir = <20221 20222 20223 20224 20225 20226 20227 20228 20229 20021 20202 20203 20204 20207 20208>;
		platform_support_project_commandline = "ili9881h","ili9881h","ili9881h","ili9881h","ili9881h","ili9881h","ili9881h","ili9881h","ili9881h","ili9881h","ili9881h","ili9881h","ili9881h","ili9881h","ili9881h";
		pinctrl-names = "default", "suspend";
		pinctrl-0 = <&ts_int_active &ts_reset_active>;
		pinctrl-1 = <&ts_int_suspend &ts_reset_suspend>;

		incell_screen;
		irq_need_dev_resume_ok;
		fw_edge_limit_support;
		black_gesture_support;
		charger_pump_support;
		headset_pump_support;
		esd_handle_support;
		//spurious_fingerprint_support;
		//lcd_trigger_fp_check;
		black_gesture_test_support;
		noflash_support;
		smart_gesture_support;
		pressure_report_support;
		fw_update_app_support;
		game_switch_support;
		drlimit_remove_support;
		lcd_trigger_load_tp_fw_support;
		suspend_gesture_cfg;
		fw_update_in_probe_with_headfile;
		health_monitor_v2_support;

		touchpanel,button-type = <4>;
	};
	novatek@1 {
		compatible = "novatek,nf_nt36525b";
		reg = <1>;
		chip-name = "NF_NT36525B";
		status = "ok";

		spi-max-frequency = <15000000>;	//4800000,9600000,15000000,19200000
		reset-gpio = <&tlmm 103 0x00>;
		interrupt-parent = <&tlmm>;
		interrupts = <104 0x0>;
		irq-gpio = <&tlmm 104 0x2002>;

		touchpanel,max-num-support = <10>;
		touchpanel,tx-rx-num = <18 32>;
		touchpanel,panel-coords = <720 1600>;
		touchpanel,display-coords = <720 1600>;
		touchpanel,touchmajor-limit = <0 54>;

		platform_support_project = <20221 20222 20223 20224 20225 20226 20227 20228 20229 20021 20202 20203 20204 20207 20208>;
		platform_support_project_dir = <20221 20222 20223 20224 20225 20226 20227 20228 20229 20021 20202 20203 20204 20207 20208>;
		platform_support_project_commandline = "nt36525","nt36525","nt36525","nt36525","nt36525","nt36525","nt36525","nt36525","nt36525","nt36525","nt36525","nt36525","nt36525","nt36525","nt36525";
		pinctrl-names = "default", "suspend";
		pinctrl-0 = <&ts_int_active &ts_reset_active>;
		pinctrl-1 = <&ts_int_suspend &ts_reset_suspend>;

		incell_screen;
		irq_need_dev_resume_ok;
		fw_edge_limit_support;
		black_gesture_support;
		charger_pump_support;
		headset_pump_support;
		esd_handle_support;
		//spurious_fingerprint_support;
		//lcd_trigger_fp_check;
		black_gesture_test_support;
		noflash_support;
		smart_gesture_support;
		pressure_report_support;
		fw_update_app_support;
		game_switch_support;
		drlimit_remove_support;
		lcd_trigger_load_tp_fw_support;
		fw_update_in_probe_with_headfile;
		health_monitor_v2_support;

		touchpanel,button-type = <4>;
	};
	ilitek2_spi@2 {
		compatible = "ilitek,ili9882n";
		reg = <2>;
		chip-name = "NF_ILI9882N";
		status = "ok";

		spi-max-frequency = <12000000>;    //4800000,9600000,15000000,19200000
		reset-gpio = <&tlmm 103 0x00>;
		interrupt-parent = <&tlmm>;
		interrupts = <104 0x0>;
		irq-gpio = <&tlmm 104 0x2002>;

		touchpanel,irq_need_dev_resume_time = <500>;
		touchpanel,max-num-support = <10>;
		touchpanel,tx-rx-num = <18 32>;
		touchpanel,panel-coords = <720 1600>;
		touchpanel,display-coords = <720 1600>;
		touchpanel,touchmajor-limit = <0 54>;

		platform_support_project = <20221 20222 20223 20224 20225 20226 20227 20228 20229 20021 20202 20203 20204 20207 20208>;
		platform_support_project_dir = <20221 20222 20223 20224 20225 20226 20227 20228 20229 20021 20202 20203 20204 20207 20208>;
		platform_support_project_commandline = "ili9882n","ili9882n","ili9882n","ili9882n","ili9882n","ili9882n","ili9882n","ili9882n","ili9882n","ili9882n","ili9882n","ili9882n","ili9882n","ili9882n","ili9882n";
		pinctrl-names = "default", "suspend";
		pinctrl-0 = <&ts_int_active &ts_reset_active>;
		pinctrl-1 = <&ts_int_suspend &ts_reset_suspend>;

		incell_screen;
		irq_need_dev_resume_ok;
		fw_edge_limit_support;
		black_gesture_support;
		charger_pump_support;
		headset_pump_support;
		esd_handle_support;
		//spurious_fingerprint_support;
		//lcd_trigger_fp_check;
		black_gesture_test_support;
		noflash_support;
		smart_gesture_support;
		pressure_report_support;
		fw_update_app_support;
		game_switch_support;
		drlimit_remove_support;
		lcd_trigger_load_tp_fw_support;
		suspend_gesture_cfg;
		fw_update_in_probe_with_headfile;
		health_monitor_v2_support;

		touchpanel,button-type = <4>;
	};
};

/* Gaofei, 2020/01/08, Add for panel bring up */
&dsi_td4330_truly_v2_video {
	qcom,panel-supply-entries = <&dsi_panel_pwr_supply>;
	qcom,mdss-dsi-bl-pmic-control-type = "bl_ctrl_pwm";
	pwms = <&pm6125_pwm 0 0>;
	qcom,bl-pmic-pwm-period-usecs = <100>;
	qcom,mdss-dsi-bl-min-level = <1>;
	qcom,mdss-dsi-bl-max-level = <4095>;
	qcom,platform-reset-gpio = <&tlmm 82 0>;
	qcom,platform-bklight-en-gpio = <&pmi632_gpios 6 0>;
};

&dsi_td4330_truly_v2_cmd {
	qcom,panel-supply-entries = <&dsi_panel_pwr_supply>;
	qcom,mdss-dsi-bl-pmic-control-type = "bl_ctrl_pwm";
	pwms = <&pm6125_pwm 0 0>;
	qcom,bl-pmic-pwm-period-usecs = <100>;
	qcom,mdss-dsi-bl-min-level = <1>;
	qcom,mdss-dsi-bl-max-level = <4095>;
	qcom,platform-te-gpio = <&tlmm 81 0>;
	qcom,platform-reset-gpio = <&tlmm 82 0>;
	qcom,platform-bklight-en-gpio = <&pmi632_gpios 6 0>;
};

&dsi_ili9881h_boe_video {
	qcom,panel-supply-entries = <&dsi_panel_pwr_supply>;
	qcom,mdss-dsi-bl-pmic-control-type = "bl_ctrl_dcs";
	pwms = <&pm6125_pwm 0 0>;
	qcom,bl-pmic-pwm-period-usecs = <100>;
	qcom,mdss-dsi-bl-min-level = <1>;
	qcom,mdss-dsi-bl-normal-max-level = <2047>;
	qcom,mdss-dsi-bl-max-level = <2047>;
	qcom,mdss-brightness-normal-max-level = <2047>;
	qcom,mdss-brightness-max-level = <2047>;
	qcom,platform-te-gpio = <&tlmm 81 0>;
	qcom,platform-reset-gpio = <&tlmm 85 0>;
	qcom,platform-bklight-en-gpio = <&pmi632_gpios 6 0>;
};

&dsi_nt36525b_inx_video {
	qcom,panel-supply-entries = <&dsi_panel_pwr_supply>;
	qcom,mdss-dsi-bl-pmic-control-type = "bl_ctrl_dcs";
	pwms = <&pm6125_pwm 0 0>;
	qcom,bl-pmic-pwm-period-usecs = <100>;
	qcom,mdss-dsi-bl-min-level = <1>;
	qcom,mdss-dsi-bl-normal-max-level = <2047>;
	qcom,mdss-dsi-bl-max-level = <2047>;
	qcom,mdss-brightness-normal-max-level = <2047>;
	qcom,mdss-brightness-max-level = <2047>;
	qcom,platform-te-gpio = <&tlmm 81 0>;
	qcom,platform-reset-gpio = <&tlmm 85 0>;
	qcom,platform-bklight-en-gpio = <&pmi632_gpios 6 0>;
};

&dsi_ili9881h_90hz_boe_video {
	qcom,panel-supply-entries = <&dsi_panel_pwr_supply>;
	qcom,mdss-dsi-bl-pmic-control-type = "bl_ctrl_dcs";
	pwms = <&pm6125_pwm 0 0>;
	qcom,bl-pmic-pwm-period-usecs = <100>;
	qcom,mdss-dsi-bl-min-level = <1>;
	qcom,mdss-dsi-bl-normal-max-level = <3383>;
	qcom,mdss-dsi-bl-max-level = <4095>;
	qcom,mdss-brightness-normal-max-level = <3383>;
	qcom,mdss-brightness-max-level = <4095>;
	qcom,mdss-brightness-default-level = <400>;
	qcom,platform-te-gpio = <&tlmm 81 0>;
	qcom,platform-reset-gpio = <&tlmm 85 0>;
	qcom,platform-bklight-en-gpio = <&pmi632_gpios 6 0>;
};

&dsi_nt36525b_90hz_inx_video {
	qcom,panel-supply-entries = <&dsi_panel_pwr_supply>;
	qcom,mdss-dsi-bl-pmic-control-type = "bl_ctrl_dcs";
	pwms = <&pm6125_pwm 0 0>;
	qcom,bl-pmic-pwm-period-usecs = <100>;
	qcom,mdss-dsi-bl-min-level = <1>;
	qcom,mdss-dsi-bl-normal-max-level = <3562>;
	qcom,mdss-dsi-bl-max-level = <4095>;
	qcom,mdss-brightness-normal-max-level = <3562>;
	qcom,mdss-brightness-max-level = <4095>;
	qcom,mdss-brightness-default-level = <400>;
	qcom,platform-te-gpio = <&tlmm 81 0>;
	qcom,platform-reset-gpio = <&tlmm 85 0>;
	qcom,platform-bklight-en-gpio = <&pmi632_gpios 6 0>;
};

&dsi_ili9881h_90hz_hlt_video {
	qcom,panel-supply-entries = <&dsi_panel_pwr_supply>;
	qcom,mdss-dsi-bl-pmic-control-type = "bl_ctrl_dcs";
	pwms = <&pm6125_pwm 0 0>;
	qcom,bl-pmic-pwm-period-usecs = <100>;
	qcom,mdss-dsi-bl-min-level = <1>;
	qcom,mdss-dsi-bl-normal-max-level = <3562>;
	qcom,mdss-dsi-bl-max-level = <4095>;
	qcom,mdss-brightness-normal-max-level = <3562>;
	qcom,mdss-brightness-max-level = <4095>;
	qcom,mdss-brightness-default-level = <400>;
	qcom,platform-te-gpio = <&tlmm 81 0>;
	qcom,platform-reset-gpio = <&tlmm 85 0>;
	qcom,platform-bklight-en-gpio = <&pmi632_gpios 6 0>;
};

&dsi_ili9882n_90hz_txd_video {
	qcom,panel-supply-entries = <&dsi_panel_pwr_supply>;
	qcom,mdss-dsi-bl-pmic-control-type = "bl_ctrl_dcs";
	pwms = <&pm6125_pwm 0 0>;
	qcom,bl-pmic-pwm-period-usecs = <100>;
	qcom,mdss-dsi-bl-min-level = <1>;
	qcom,mdss-dsi-bl-normal-max-level = <3562>;
	qcom,mdss-dsi-bl-max-level = <4095>;
	qcom,mdss-brightness-normal-max-level = <3562>;
	qcom,mdss-brightness-max-level = <4095>;
	qcom,mdss-brightness-default-level = <400>;
	qcom,platform-te-gpio = <&tlmm 81 0>;
	qcom,platform-reset-gpio = <&tlmm 85 0>;
	qcom,platform-bklight-en-gpio = <&pmi632_gpios 6 0>;
};

&dsi_ili9882n_90hz_boe_video {
	qcom,panel-supply-entries = <&dsi_panel_pwr_supply>;
	qcom,mdss-dsi-bl-pmic-control-type = "bl_ctrl_dcs";
	pwms = <&pm6125_pwm 0 0>;
	qcom,bl-pmic-pwm-period-usecs = <100>;
	qcom,mdss-dsi-bl-min-level = <1>;
	qcom,mdss-dsi-bl-normal-max-level = <3383>;
	qcom,mdss-dsi-bl-max-level = <4095>;
	qcom,mdss-brightness-normal-max-level = <3383>;
	qcom,mdss-brightness-max-level = <4095>;
	qcom,mdss-brightness-default-level = <400>;
	qcom,platform-te-gpio = <&tlmm 81 0>;
	qcom,platform-reset-gpio = <&tlmm 85 0>;
	qcom,platform-bklight-en-gpio = <&pmi632_gpios 6 0>;
};

&dsi_ili9882n_90hz_inx_video {
	qcom,panel-supply-entries = <&dsi_panel_pwr_supply>;
	qcom,mdss-dsi-bl-pmic-control-type = "bl_ctrl_dcs";
	pwms = <&pm6125_pwm 0 0>;
	qcom,bl-pmic-pwm-period-usecs = <100>;
	qcom,mdss-dsi-bl-min-level = <1>;
	qcom,mdss-dsi-bl-normal-max-level = <3562>;
	qcom,mdss-dsi-bl-max-level = <4095>;
	qcom,mdss-brightness-normal-max-level = <3562>;
	qcom,mdss-brightness-max-level = <4095>;
	qcom,mdss-brightness-default-level = <400>;
	qcom,platform-te-gpio = <&tlmm 81 0>;
	qcom,platform-reset-gpio = <&tlmm 85 0>;
	qcom,platform-bklight-en-gpio = <&pmi632_gpios 6 0>;
};

&dsi_ili9881h_boe_video {
	qcom,mdss-dsi-t-clk-post = <0x0C>;
	qcom,mdss-dsi-t-clk-pre = <0x29>;
	qcom,dsi-dyn-clk-enable;
	qcom,dsi-dyn-clk-list =
		<718968960 715973256>;
	qcom,dsi-select-clocks = "mux_byte_clk0", "mux_pixel_clk0",
				"src_byte_clk0", "src_pixel_clk0",
				"shadow_byte_clk0", "shadow_pixel_clk0";

	qcom,mdss-dsi-display-timings {
		timing@0{
			qcom,mdss-dsi-panel-phy-timings =
				[21 1D 07 08 04 02 04 a0
				21 1D 07 08 04 02 04 a0
				21 1D 07 08 04 02 04 a0
				21 1D 07 08 04 02 04 a0
				21 16 06 07 04 02 04 a0];

			qcom,display-topology = <1 0 1>;
			qcom,default-topology-index = <0>;
		};
	};
};

&dsi_nt36525b_inx_video {
	qcom,mdss-dsi-t-clk-post = <0x0C>;
	qcom,mdss-dsi-t-clk-pre = <0x29>;
	qcom,dsi-select-clocks = "mux_byte_clk0", "mux_pixel_clk0",
				"src_byte_clk0", "src_pixel_clk0",
				"shadow_byte_clk0", "shadow_pixel_clk0";

	qcom,mdss-dsi-display-timings {
		timing@0{
			qcom,mdss-dsi-panel-phy-timings =
				[21 1D 07 08 04 02 04 a0
				21 1D 07 08 04 02 04 a0
				21 1D 07 08 04 02 04 a0
				21 1D 07 08 04 02 04 a0
				21 16 06 07 04 02 04 a0];

			qcom,display-topology = <1 0 1>;
			qcom,default-topology-index = <0>;
		};
	};
};

&dsi_ili9881h_90hz_boe_video {
	qcom,mdss-dsi-t-clk-post = <0x0D>;
	qcom,mdss-dsi-t-clk-pre = <0x2D>;
	qcom,dsi-supported-dfps-list = <60 90>;
	qcom,mdss-dsi-pan-enable-dynamic-fps;
	qcom,mdss-dsi-pan-fps-update =
		"dfps_immediate_porch_mode_vfp";
	qcom,mdss-dsi-min-refresh-rate = <60>;
	qcom,mdss-dsi-max-refresh-rate = <90>;
	oplus,dfps-idle-off;
	qcom,esd-check-enabled;
	qcom,mdss-dsi-panel-status-check-mode = "reg_read";
	qcom,mdss-dsi-panel-status-command = [06 01 00 01 00 00 01 0a];
	qcom,mdss-dsi-panel-status-command-state = "dsi_lp_mode";
	qcom,mdss-dsi-panel-status-value = <0x9c>;
	qcom,mdss-dsi-panel-on-check-value = <0x9c>;
	qcom,mdss-dsi-panel-status-read-length = <1>;
	qcom,dsi-select-clocks = "mux_byte_clk0", "mux_pixel_clk0",
				"src_byte_clk0", "src_pixel_clk0",
				"shadow_byte_clk0", "shadow_pixel_clk0";
	qcom,dsi-dyn-clk-enable;
	qcom,dsi-dyn-clk-list =
		<833172480 844744320>;

	qcom,mdss-dsi-display-timings {
		timing@0{
			qcom,mdss-dsi-panel-phy-timings =
				[23 1E 07 09 05 02 04 a0
				23 1E 07 09 05 02 04 a0
				23 1E 07 09 05 02 04 a0
				23 1E 07 09 05 02 04 a0
				23 19 07 08 05 02 04 a0];

			qcom,display-topology = <1 0 1>;
			qcom,default-topology-index = <0>;
		};
	};
};

&dsi_nt36525b_90hz_inx_video {
	qcom,mdss-dsi-t-clk-post = <0x0D>;
	qcom,mdss-dsi-t-clk-pre = <0x2D>;
	qcom,dsi-supported-dfps-list = <60 90>;
	qcom,mdss-dsi-pan-enable-dynamic-fps;
	qcom,mdss-dsi-pan-fps-update =
		"dfps_immediate_porch_mode_vfp";
	qcom,mdss-dsi-min-refresh-rate = <60>;
	qcom,mdss-dsi-max-refresh-rate = <90>;
	oplus,dfps-idle-off;
	qcom,esd-check-enabled;
	qcom,mdss-dsi-panel-status-check-mode = "reg_read";
	qcom,mdss-dsi-panel-status-command = [06 01 00 01 00 00 01 0a];
	qcom,mdss-dsi-panel-status-command-state = "dsi_lp_mode";
	qcom,mdss-dsi-panel-status-value = <0x9c>;
	qcom,mdss-dsi-panel-on-check-value = <0x9c>;
	qcom,mdss-dsi-panel-status-read-length = <1>;
	qcom,dsi-select-clocks = "mux_byte_clk0", "mux_pixel_clk0",
				"src_byte_clk0", "src_pixel_clk0",
				"shadow_byte_clk0", "shadow_pixel_clk0";
	qcom,dsi-dyn-clk-enable;
	qcom,dsi-dyn-clk-list =
		<833029920 844599784>;
	qcom,dsi-dyn-clk-type = "constant-fps-adjust-hfp";

	qcom,mdss-dsi-display-timings {
		timing@0{
			qcom,mdss-dsi-panel-phy-timings =
				[23 1E 07 09 05 02 04 a0
				23 1E 07 09 05 02 04 a0
				23 1E 07 09 05 02 04 a0
				23 1E 07 09 05 02 04 a0
				23 19 07 08 05 02 04 a0];

			qcom,display-topology = <1 0 1>;
			qcom,default-topology-index = <0>;
		};
	};
};

&dsi_ili9881h_90hz_hlt_video {
	qcom,mdss-dsi-t-clk-post = <0x0D>;
	qcom,mdss-dsi-t-clk-pre = <0x2D>;
	qcom,dsi-supported-dfps-list = <60 90>;
	qcom,mdss-dsi-pan-enable-dynamic-fps;
	qcom,mdss-dsi-pan-fps-update =
		"dfps_immediate_porch_mode_vfp";
	qcom,mdss-dsi-min-refresh-rate = <60>;
	qcom,mdss-dsi-max-refresh-rate = <90>;
	oplus,dfps-idle-off;
	qcom,esd-check-enabled;
	qcom,mdss-dsi-panel-status-check-mode = "reg_read";
	qcom,mdss-dsi-panel-status-command = [06 01 00 01 00 00 01 0a];
	qcom,mdss-dsi-panel-status-command-state = "dsi_lp_mode";
	qcom,mdss-dsi-panel-status-value = <0x9c>;
	qcom,mdss-dsi-panel-on-check-value = <0x9c>;
	qcom,mdss-dsi-panel-status-read-length = <1>;
	qcom,dsi-select-clocks = "mux_byte_clk0", "mux_pixel_clk0",
				"src_byte_clk0", "src_pixel_clk0",
				"shadow_byte_clk0", "shadow_pixel_clk0";
	qcom,dsi-dyn-clk-enable;
	qcom,dsi-dyn-clk-list =
		<833172480 844744320>;

	qcom,mdss-dsi-display-timings {
		timing@0{
			qcom,mdss-dsi-panel-phy-timings =
				[23 1E 07 09 05 02 04 a0
				23 1E 07 09 05 02 04 a0
				23 1E 07 09 05 02 04 a0
				23 1E 07 09 05 02 04 a0
				23 19 07 08 05 02 04 a0];

			qcom,display-topology = <1 0 1>;
			qcom,default-topology-index = <0>;
		};
	};
};

&dsi_ili9882n_90hz_txd_video {
	qcom,mdss-dsi-t-clk-post = <0x0D>;
	qcom,mdss-dsi-t-clk-pre = <0x2D>;
	qcom,dsi-supported-dfps-list = <60 90>;
	qcom,mdss-dsi-pan-enable-dynamic-fps;
	qcom,mdss-dsi-pan-fps-update =
		"dfps_immediate_porch_mode_vfp";
	qcom,mdss-dsi-min-refresh-rate = <60>;
	qcom,mdss-dsi-max-refresh-rate = <90>;
	oplus,dfps-idle-off;
	qcom,esd-check-enabled;
	qcom,mdss-dsi-panel-status-check-mode = "reg_read";
	qcom,mdss-dsi-panel-status-command = [06 01 00 01 00 00 01 0a];
	qcom,mdss-dsi-panel-status-command-state = "dsi_lp_mode";
	qcom,mdss-dsi-panel-status-value = <0x9c>;
	qcom,mdss-dsi-panel-on-check-value = <0x9c>;
	qcom,mdss-dsi-panel-status-read-length = <1>;
	qcom,dsi-select-clocks = "mux_byte_clk0", "mux_pixel_clk0",
				"src_byte_clk0", "src_pixel_clk0",
				"shadow_byte_clk0", "shadow_pixel_clk0";
	qcom,dsi-dyn-clk-enable;
	qcom,dsi-dyn-clk-list =
		<833580720 842842728>;

	qcom,mdss-dsi-display-timings {
		timing@0{
			qcom,mdss-dsi-panel-phy-timings =
				[23 1E 07 09 05 02 04 a0
				23 1E 07 09 05 02 04 a0
				23 1E 07 09 05 02 04 a0
				23 1E 07 09 05 02 04 a0
				23 19 07 08 05 02 04 a0];

			qcom,display-topology = <1 0 1>;
			qcom,default-topology-index = <0>;
		};
	};
};

&dsi_ili9882n_90hz_boe_video {
	qcom,mdss-dsi-t-clk-post = <0x0D>;
	qcom,mdss-dsi-t-clk-pre = <0x2D>;
	qcom,dsi-supported-dfps-list = <60 90>;
	qcom,mdss-dsi-pan-enable-dynamic-fps;
	qcom,mdss-dsi-pan-fps-update =
		"dfps_immediate_porch_mode_vfp";
	qcom,mdss-dsi-min-refresh-rate = <60>;
	qcom,mdss-dsi-max-refresh-rate = <90>;
	oplus,dfps-idle-off;
	qcom,esd-check-enabled;
	qcom,mdss-dsi-panel-status-check-mode = "reg_read";
	qcom,mdss-dsi-panel-status-command = [06 01 00 01 00 00 01 0a];
	qcom,mdss-dsi-panel-status-command-state = "dsi_lp_mode";
	qcom,mdss-dsi-panel-status-value = <0x9c>;
	qcom,mdss-dsi-panel-on-check-value = <0x9c>;
	qcom,mdss-dsi-panel-status-read-length = <1>;
	qcom,dsi-select-clocks = "mux_byte_clk0", "mux_pixel_clk0",
				"src_byte_clk0", "src_pixel_clk0",
				"shadow_byte_clk0", "shadow_pixel_clk0";
	qcom,dsi-dyn-clk-enable;
	qcom,dsi-dyn-clk-list =
		<833554800 845131954>;

	qcom,mdss-dsi-display-timings {
		timing@0{
			qcom,mdss-dsi-panel-phy-timings =
				[23 1E 07 09 05 02 04 a0
				23 1E 07 09 05 02 04 a0
				23 1E 07 09 05 02 04 a0
				23 1E 07 09 05 02 04 a0
				23 19 07 08 05 02 04 a0];

			qcom,display-topology = <1 0 1>;
			qcom,default-topology-index = <0>;
		};
	};
};

&dsi_ili9882n_90hz_inx_video {
	qcom,mdss-dsi-t-clk-post = <0x0D>;
	qcom,mdss-dsi-t-clk-pre = <0x2D>;
	qcom,dsi-supported-dfps-list = <60 90>;
	qcom,mdss-dsi-pan-enable-dynamic-fps;
	qcom,mdss-dsi-pan-fps-update =
		"dfps_immediate_porch_mode_vfp";
	qcom,mdss-dsi-min-refresh-rate = <60>;
	qcom,mdss-dsi-max-refresh-rate = <90>;
	oplus,dfps-idle-off;
	qcom,esd-check-enabled;
	qcom,mdss-dsi-panel-status-check-mode = "reg_read";
	qcom,mdss-dsi-panel-status-command = [06 01 00 01 00 00 01 0a];
	qcom,mdss-dsi-panel-status-command-state = "dsi_lp_mode";
	qcom,mdss-dsi-panel-status-value = <0x9c>;
	qcom,mdss-dsi-panel-on-check-value = <0x9c>;
	qcom,mdss-dsi-panel-status-read-length = <1>;
	qcom,dsi-select-clocks = "mux_byte_clk0", "mux_pixel_clk0",
				"src_byte_clk0", "src_pixel_clk0",
				"shadow_byte_clk0", "shadow_pixel_clk0";
	qcom,dsi-dyn-clk-enable;
	qcom,dsi-dyn-clk-list =
		<833580720 842842728>;

	qcom,mdss-dsi-display-timings {
		timing@0{
			qcom,mdss-dsi-panel-phy-timings =
				[23 1E 07 09 05 02 04 a0
				23 1E 07 09 05 02 04 a0
				23 1E 07 09 05 02 04 a0
				23 1E 07 09 05 02 04 a0
				23 19 07 08 05 02 04 a0];

			qcom,display-topology = <1 0 1>;
			qcom,default-topology-index = <0>;
		};
	};
};
//#endif

//#ifdef OPLUS_FEATURE_CHG_BASIC
// Yichun.Chen  PSW.BSP.CHG  2019-05-30  oppo charge edit dts
#include "oplus-charge.dtsi"
//endif
