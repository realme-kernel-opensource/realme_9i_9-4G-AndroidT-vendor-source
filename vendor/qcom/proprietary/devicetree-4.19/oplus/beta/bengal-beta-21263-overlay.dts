/dts-v1/;
/plugin/;

#include "../../qcom/bengal-pmi632.dtsi"
#include "bengal-beta-overlay.dtsi"
#include "bengal-beta-21263-overlay.dtsi"

/ {
	model = "Qualcomm Technologies, Inc. Bengal QRD";
	compatible = "qcom,bengal-qrd", "qcom,bengal", "qcom,qrd";
	qcom,board-id = <0x1000B 0>;
	oplus,dtsi_no = <21263>;
};
