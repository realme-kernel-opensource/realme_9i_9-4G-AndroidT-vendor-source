/dts-v1/;

#include "../../qcom/bengal.dtsi"
#include "../../qcom/bengal-qrd.dtsi"

/ {
	model = "Qualcomm Technologies, Inc. Bengal QRD";
	compatible = "qcom,bengal-qrd", "qcom,bengal", "qcom,qrd";
	qcom,board-id = <0x1000B 0>;
};
