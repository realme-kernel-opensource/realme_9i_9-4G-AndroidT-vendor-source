/dts-v1/;
/plugin/;

#include "../../qcom/bengal-pmi632.dtsi"
#include "bengal-rum-overlay.dtsi"
#include "bengal-rum-20211-overlay-legacy.dtsi"

/ {
	model = "Qualcomm Technologies, Inc. Bengal QRD";
	compatible = "qcom,bengal-qrd", "qcom,bengal", "qcom,qrd";
	qcom,board-id = <0x1000B 0>;
	oplus,dtsi_no = <20211>;
	oplus,pcb-legancy-version = <1>; // before evt2
};

#include "sensor/rum-20211-sensor-mtp.dtsi"