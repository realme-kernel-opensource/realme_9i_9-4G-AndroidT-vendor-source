&mdss_mdp {
	dsi_hx83112a_tm_90hz_video: qcom,mdss_dsi_hx83112a_tm_90hz_video {
		qcom,mdss-dsi-panel-name =
			"hx83112a video mode dsi tm 90hz panel";
		qcom,mdss-dsi-panel-type = "dsi_video_mode";

		qcom,dsi-ctrl-num = <0>;
		qcom,dsi-phy-num = <0>;

		qcom,mdss-dsi-virtual-channel-id = <0>;
		qcom,mdss-dsi-stream = <0>;
		qcom,mdss-dsi-h-left-border = <0>;
		qcom,mdss-dsi-h-right-border = <0>;
		qcom,mdss-dsi-v-top-border = <0>;
		qcom,mdss-dsi-v-bottom-border = <0>;
		qcom,mdss-dsi-bpp = <24>;
		qcom,mdss-dsi-color-order = "rgb_swap_rgb";
		qcom,mdss-dsi-underflow-color = <0xff>;
		qcom,mdss-dsi-border-color = <0>;
		qcom,mdss-dsi-h-sync-pulse = <0>;
		qcom,mdss-dsi-traffic-mode = "non_burst_sync_event";
		qcom,mdss-dsi-lane-map = "lane_map_0123";
		qcom,mdss-dsi-bllp-eof-power-mode;
		qcom,mdss-dsi-bllp-power-mode;
		qcom,mdss-dsi-tx-eot-append;
		qcom,mdss-dsi-lane-0-state;
		qcom,mdss-dsi-lane-1-state;
		qcom,mdss-dsi-lane-2-state;
		qcom,mdss-dsi-lane-3-state;
		qcom,mdss-dsi-dma-trigger = "trigger_sw";
		qcom,mdss-dsi-mdp-trigger = "none";
		qcom,mdss-dsi-lp11-init;
		qcom,mdss-dsi-bl-pmic-control-type = "bl_ctrl_dcs";
		qcom,mdss-dsi-bl-min-level = <1>;
		qcom,mdss-dsi-bl-max-level = <4095>;
		qcom,mdss-brightness-max-level = <4095>;
		qcom,mdss-dsi-bl-normal-max-level = <2047>;
		qcom,mdss-brightness-normal-max-level = <2047>;
		qcom,mdss-brightness-default-level = <1024>;
                oplus,dsi-brightness-remapping = <1 1>,
                                                 <3 3>,
                                                 <4 5>,
                                                 <2047 3052>,
                                                 <4095 4095>;

		qcom,mdss-dsi-reset-sequence = <1 2>, <0 10>, <1 52>;
		qcom,mdss-pan-physical-width-dimension = <68>;
		qcom,mdss-pan-physical-height-dimension = <151>;
		oplus,mdss-dsi-vendor-name = "HX83112A";
		oplus,mdss-dsi-manufacture = "TIANMA";

		qcom,mdss-dsi-display-timings {
			timing@0 {
				qcom,mdss-dsi-panel-width = <720>;
				qcom,mdss-dsi-panel-height = <1600>;
				qcom,mdss-dsi-h-front-porch = <80>;
				qcom,mdss-dsi-h-back-porch = <80>;
				qcom,mdss-dsi-h-pulse-width = <8>;
				qcom,mdss-dsi-h-sync-skew = <0>;
				qcom,mdss-dsi-v-back-porch = <8>;
				qcom,mdss-dsi-v-front-porch = <40>;
				qcom,mdss-dsi-v-pulse-width = <99>;
				qcom,mdss-dsi-panel-framerate = <90>;
				qcom,mdss-dsi-on-command = [
					39 01 00 00 00 00 04 B9 83 11 2A
					39 01 00 00 00 00 05 CF 00 14 00 C0
					15 01 00 00 00 00 02 35 00
					05 01 00 00 3E 00 02 11 00         //delay 62ms
					39 01 00 00 00 00 03 5E 00 04
					39 01 00 00 00 00 03 51 08 00
					39 01 00 00 00 00 05 C9 00 0F 1D 01  //PWM=17.5KHZ
					15 01 00 00 06 00 02 55 01
					15 01 00 00 00 00 02 53 24
					39 01 00 00 00 00 04 B9 00 00 00
					05 01 00 00 16 00 02 29 00];       //delay 22ms
				qcom,mdss-dsi-off-command = [
					05 01 00 00 22 00 02 28 00
					05 01 00 00 82 00 02 10 00]; //delay 130ms
				qcom,mdss-dsi-cabc-off-command = [
					15 01 00 00 05 00 02 55 00];
				qcom,mdss-dsi-cabc-ui-command = [
					15 01 00 00 05 00 02 55 01
					39 01 00 00 05 00 04 B9 83 11 2A
					39 01 00 00 05 00 17 E4 2D 01 2C 00 08 00 10 08 04 04 34 4B 60 75 98 CA 79 B1 E9 FF FF EF
					39 01 00 00 05 00 04 B9 00 00 00];
				qcom,mdss-dsi-cabc-still-image-command = [
					15 01 00 00 05 00 02 55 02
					39 01 00 00 05 00 04 B9 83 11 2A
					39 01 00 00 05 00 17 E4 2D 01 2C 00 08 00 10 08 04 04 7F 93 A8 BF D8 12 AD 20 80 AA EE EF
					39 01 00 00 05 00 04 B9 00 00 00];
				qcom,mdss-dsi-cabc-video-command = [
					15 01 00 00 05 00 02 55 03
					39 01 00 00 05 00 04 B9 83 11 2A
					39 01 00 00 05 00 17 E4 2D 01 2C 00 08 00 10 08 04 04 CF 08 43 70 9C C8 7E E8 60 A9 AA EF
					39 01 00 00 05 00 04 B9 00 00 00];
				qcom,mdss-dsi-cabc-off-command-state = "dsi_hs_mode";
				qcom,mdss-dsi-cabc-ui-command-state = "dsi_hs_mode";
				qcom,mdss-dsi-cabc-still-image-command-state = "dsi_hs_mode";
				qcom,mdss-dsi-cabc-video-command-state = "dsi_hs_mode";
				qcom,mdss-dsi-on-command-state = "dsi_lp_mode";
				qcom,mdss-dsi-off-command-state = "dsi_lp_mode";
			};
		};
	};
};
