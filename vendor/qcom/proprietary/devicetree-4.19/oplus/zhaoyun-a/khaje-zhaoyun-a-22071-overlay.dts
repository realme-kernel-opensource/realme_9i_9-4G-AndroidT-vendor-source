/dts-v1/;
/plugin/;

#include "../../qcom/khaje-qrd-nopmi-overlay.dts"
#include "khaje_overlay_common.dtsi"
#include "khaje_22071_overlay_common.dtsi"

#include "audio/khaje-zhaoyun-a-audio-overlay.dtsi"

/ {
    model = "Qualcomm Technologies, Inc. KHAJE QRD nopmi overlay, zhaoyun-a";
    oplus,dtsi_no = <22071 22072>;
};

