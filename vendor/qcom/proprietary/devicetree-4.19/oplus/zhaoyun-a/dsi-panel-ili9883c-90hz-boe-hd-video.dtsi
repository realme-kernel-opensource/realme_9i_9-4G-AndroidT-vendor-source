&mdss_mdp {
	dsi_ili9883c_90hz_boe_video: qcom,mdss_dsi_ili9883c_90hz_boe_video {
		qcom,mdss-dsi-panel-name =
				"ili9883c 90hz boe hd video mode dsi panel";
		qcom,mdss-dsi-panel-type = "dsi_video_mode";
		qcom,dsi-ctrl-num = <0>;
		qcom,dsi-phy-num = <0>;
		qcom,mdss-dsi-virtual-channel-id = <0>;
		qcom,mdss-dsi-stream = <0>;
		qcom,mdss-dsi-h-left-border = <0>;
		qcom,mdss-dsi-h-right-border = <0>;
		qcom,mdss-dsi-v-top-border = <0>;
		qcom,mdss-dsi-v-bottom-border = <0>;
		qcom,mdss-dsi-bpp = <24>;
		qcom,mdss-dsi-color-order = "rgb_swap_rgb";
		qcom,mdss-dsi-underflow-color = <0xff>;
		qcom,mdss-dsi-border-color = <0>;
		qcom,mdss-dsi-h-sync-pulse = <0>;
		qcom,mdss-dsi-traffic-mode = "non_burst_sync_event";
		qcom,mdss-dsi-lane-map = "lane_map_0123";
		qcom,mdss-dsi-bllp-eof-power-mode;
		qcom,mdss-dsi-bllp-power-mode;
		qcom,ulps-enabled;
		qcom,suspend-ulps-enabled;
		qcom,mdss-dsi-tx-eot-append;
		qcom,mdss-dsi-lane-0-state;
		qcom,mdss-dsi-lane-1-state;
		qcom,mdss-dsi-lane-2-state;
		qcom,mdss-dsi-lane-3-state;
		qcom,mdss-dsi-dma-trigger = "trigger_sw";
		qcom,mdss-dsi-mdp-trigger = "none";
		qcom,mdss-dsi-lp11-init;
		qcom,mdss-dsi-bl-pmic-control-type = "bl_ctrl_dcs";
		qcom,mdss-dsi-bl-min-level = <1>;
		qcom,mdss-dsi-bl-normal-max-level = <3383>;
		qcom,mdss-dsi-bl-max-level = <4095>;
		qcom,mdss-brightness-normal-max-level = <3383>;
		qcom,mdss-brightness-max-level = <4095>;
		qcom,mdss-brightness-default-level = <400>;
		qcom,mdss-dsi-reset-sequence = <1 10>, <0 10>, <1 10>;
		qcom,mdss-pan-physical-width-dimension = <68>;
		qcom,mdss-pan-physical-height-dimension = <151>;
		oplus,mdss-dsi-physical-type = "lcd";
		oplus,mdss-dsi-vendor-name = "BOEILI9883C-90HZ";
		oplus,mdss-dsi-manufacture = "BOEILI9883C";
		oplus,panel-cabc-soda;
		oplus,display-off-set-pixel-off;
		qcom,mdss-dsi-display-timings {
			timing@0 {
				qcom,mdss-dsi-video-mode;
				qcom,mdss-dsi-panel-width = <720>;
				qcom,mdss-dsi-panel-height = <1612>;
				qcom,mdss-dsi-h-front-porch = <15>;
				qcom,mdss-dsi-h-back-porch = <20>;
				qcom,mdss-dsi-h-pulse-width = <12>;
				qcom,mdss-dsi-h-sync-skew = <0>;
				qcom,mdss-dsi-v-back-porch = <30>;
				qcom,mdss-dsi-v-front-porch = <370>;
				qcom,mdss-dsi-v-pulse-width = <2>;
				qcom,mdss-dsi-panel-framerate = <90>;
				qcom,mdss-dsi-on-command = [
					39 01 00 00 00 00 04 FF 98 83 06
					39 01 00 00 00 00 02 06 A4

					39 01 00 00 00 00 04 FF 98 83 03
					39 01 00 00 00 00 02 83 20          //PWM 12bit
					39 01 00 00 00 00 02 84 01

					39 01 00 00 00 00 04 FF 98 83 03    //CABC
					39 01 00 00 00 00 02 86 6C
					39 01 00 00 00 00 02 88 E1    //hei 80%
					39 01 00 00 00 00 02 89 e8   //hui 89.84%
					39 01 00 00 00 00 02 8A F0   //shuiguo 92.97%
					39 01 00 00 00 00 02 8B F7
					39 01 00 00 00 00 02 8C BF   //hei 60.94%
					39 01 00 00 00 00 02 8D C5
					39 01 00 00 00 00 02 8E C8
					39 01 00 00 00 00 02 8F CE
					39 01 00 00 00 00 02 90 D1   //hui 69.92%
					39 01 00 00 00 00 02 91 D6
					39 01 00 00 00 00 02 92 DC
					39 01 00 00 00 00 02 93 E3
					39 01 00 00 00 00 02 94 ED
					39 01 00 00 00 00 02 95 FA   //shuiguo 73%->83.6%
					39 01 00 00 00 00 02 AF 18

					39 01 00 00 00 00 04 FF 98 83 06
					39 01 00 00 00 00 02 D6 00
					39 01 00 00 00 00 02 D7 01
					39 01 00 00 00 00 02 48 35

					39 01 00 00 00 00 04 FF 98 83 00
					39 01 00 00 00 00 02 53 24            //enable pwm
					39 01 00 00 00 00 03 51 00 00
					39 01 00 00 00 00 02 55 01            //enable cabc
					39 01 00 00 00 00 02 35 00            //TE ON
					39 01 00 00 50 00 02 11 00


					39 01 00 00 00 00 04 FF 98 83 07
					39 01 00 00 00 00 02 00 00
					39 01 00 00 00 00 02 01 00

					39 01 00 00 00 00 04 FF 98 83 00
					39 01 00 00 14 00 02 29 00
				];
				qcom,mdss-dsi-off-command = [
					39 01 00 00 00 00 04 FF 98 83 00
					39 01 00 00 14 00 02 28 00
					39 01 00 00 78 00 02 10 00
				];
				qcom,mdss-dsi-cabc-mode1-command = [
					39 01 00 00 00 00 04 FF 98 83 00
					39 01 00 00 00 00 02 55 01
				];
				qcom,mdss-dsi-cabc-mode2-command = [
					39 01 00 00 00 00 04 FF 98 83 00
					39 01 00 00 00 00 02 55 02
				];
				qcom,mdss-dsi-cabc-mode3-command = [
					39 01 00 00 00 00 04 FF 98 83 00
					39 01 00 00 00 00 02 55 03
				];
				qcom,mdss-dsi-cabc-off-command = [
					39 01 00 00 00 00 04 FF 98 83 00
					39 01 00 00 00 00 02 55 00
				];
				qcom,mdss-dsi-switch-to-page0-command = [
					39 01 00 00 00 00 04 FF 98 83 00
				];
				qcom,mdss-dsi-backlight-gamma-enter-command = [
					39 01 00 00 00 00 04 FF 98 83 08
					39 01 00 00 00 00 1E E0 00 BE C2 D0 E0 54 FB 16 2E 4F 55 6C A0 CD F9 AA 26 56 91 B6 FE E3 09 3B 77 3F A7 D6 DB
					39 01 00 00 00 00 1E E1 00 BE C2 D0 E0 54 FB 16 2E 4F 55 6C A0 CD F9 AA 26 56 91 B6 FE E3 09 3B 77 3F A7 D6 DB
					39 01 00 00 00 00 04 FF 98 83 00
				];
				qcom,mdss-dsi-backlight-gamma-exit-command = [
					39 01 00 00 00 00 04 FF 98 83 08
					39 01 00 00 00 00 1E E0 00 00 0B 2B 51 40 84 B1 D7 09 55 2F 72 A7 DB AA 09 3F 7E A4 FA D3 FC 2E 6B 3F A0 D5 DB
					39 01 00 00 00 00 1E E1 00 00 0B 2B 51 40 84 B1 D7 09 55 2F 72 A7 DB AA 09 3F 7E A4 FA D3 FC 2E 6B 3F A0 D5 DB
					39 01 00 00 00 00 04 FF 98 83 00
				];
				qcom,mdss-dsi-pixel-off-command = [
					39 01 00 08 00 00 02 22 00
				];
				qcom,mdss-dsi-on-command-state = "dsi_lp_mode";
				qcom,mdss-dsi-off-command-state = "dsi_lp_mode";
				qcom,mdss-dsi-cabc-mode1-command-state = "dsi_hs_mode";
				qcom,mdss-dsi-cabc-mode2-command-state = "dsi_hs_mode";
				qcom,mdss-dsi-cabc-mode3-command-state = "dsi_hs_mode";
				qcom,mdss-dsi-cabc-off-command-state = "dsi_hs_mode";
				qcom,mdss-dsi-switch-to-page0-command-state = "dsi_hs_mode";
				qcom,mdss-dsi-backlight-gamma-enter-command-state = "dsi_hs_mode";
				qcom,mdss-dsi-backlight-gamma-exit-command-state = "dsi_hs_mode";
				qcom,mdss-dsi-pixel-off-command-state = "dsi_hs_mode";
				qcom,mdss-dsi-panel-phy-timings =[00 1D 07 07 17 22 07
					07 08 02 04 00 19 0C];
				qcom,display-topology = <1 0 1>;
				qcom,default-topology-index = <0>;
			};
		};
	};
};