&mdss_mdp {   //for LCM(HeLiTai BLD-HTF065H047 NT36525BH)
	dsi_nt36525b_hlt_b8_video: qcom,mdss_dsi_nt36525b_hlt_b8_video {
		qcom,mdss-dsi-panel-name = "RA511_HLT_B8_NT_00";
		qcom,mdss-dsi-panel-type = "dsi_video_mode";

		qcom,dsi-ctrl-num = <0>;
		qcom,dsi-phy-num = <0>;

		qcom,mdss-dsi-virtual-channel-id = <0>;
		qcom,mdss-dsi-stream = <0>;
		qcom,mdss-dsi-h-left-border = <0>;
		qcom,mdss-dsi-h-right-border = <0>;
		qcom,mdss-dsi-v-top-border = <0>;
		qcom,mdss-dsi-v-bottom-border = <0>;
		qcom,mdss-dsi-bpp = <24>;
		qcom,mdss-dsi-color-order = "rgb_swap_rgb";
		qcom,mdss-dsi-underflow-color = <0xff>;
		qcom,mdss-dsi-border-color = <0>;
		qcom,mdss-dsi-h-sync-pulse = <0>;
		qcom,mdss-dsi-traffic-mode = "non_burst_sync_event";
		qcom,mdss-dsi-lane-map = "lane_map_0123";
		qcom,mdss-dsi-bllp-eof-power-mode;
		qcom,mdss-dsi-bllp-power-mode;
		qcom,mdss-dsi-tx-eot-append;
		qcom,mdss-dsi-lane-0-state;
		qcom,mdss-dsi-lane-1-state;
		qcom,mdss-dsi-lane-2-state;
		qcom,mdss-dsi-dma-trigger = "trigger_sw";
		qcom,mdss-dsi-mdp-trigger = "none";
		qcom,mdss-dsi-lp11-init;
		qcom,mdss-dsi-bl-pmic-control-type = "bl_ctrl_dcs";
		qcom,mdss-dsi-bl-min-level = <1>;
		qcom,mdss-dsi-bl-max-level = <4095>;
		qcom,mdss-brightness-max-level = <4095>;      //for  /sys/class/backlight/panel0-backlight/max_brightness
		qcom,mdss-dsi-bl-normal-max-level  = <2047>;  //for /sys/kernel/oplus_display/max_brightness
		qcom,mdss-brightness-normal-max-level = <2047>;  //for backlight caculation
		qcom,mdss-brightness-default-level = <2047>;
		qcom,mdss-dsi-reset-sequence = <1 10>, <0 10>, <1 10>;
		qcom,mdss-pan-physical-width-dimension = <68>;
		qcom,mdss-pan-physical-height-dimension = <151>;
		oplus,mdss-dsi-vendor-name = "NT36525B";
		oplus,mdss-dsi-manufacture = "HLT";
		oplus,dsi-brightness-remapping = <1 1>, <2 2>, <1023 1023>, <2047 2047>;//<2047 3276>, <4094 4094>, <4095 4095>;

		qcom,mdss-dsi-display-timings {
			timing@0 {
				qcom,mdss-dsi-panel-width = <720>;
				qcom,mdss-dsi-panel-height = <1600>;
				qcom,mdss-dsi-h-front-porch = <86>;
				qcom,mdss-dsi-h-back-porch = <86>;
				qcom,mdss-dsi-h-pulse-width = <43>;  //33--828M,43--837M
				qcom,mdss-dsi-h-sync-skew = <0>;
				qcom,mdss-dsi-v-back-porch = <254>;
				qcom,mdss-dsi-v-front-porch = <10>;
				qcom,mdss-dsi-v-pulse-width = <2>;
				qcom,mdss-dsi-panel-framerate = <60>;
				qcom,mdss-dsi-on-command = [
					//select CMD2--Page3
					15 01 00 00 00 00 02 FF 23
					15 01 00 00 00 00 02 FB 01
					15 01 00 00 00 00 02 00 68   //0x80--backlight 12 bit 7.5khz ,0x68--11bit
					15 01 00 00 00 00 02 07 00   //07&08&09 determine 30khz
					15 01 00 00 00 00 02 08 01
					15 01 00 00 00 00 02 09 00
					//APL_WT
					15 01 00 00 00 00 02 10 80
					//APL_THD
					15 01 00 00 00 00 02 11 00
					15 01 00 00 00 00 02 12 B4
					//APL_COMP
					15 01 00 00 00 00 02 15 E9
					15 01 00 00 00 00 02 16 0B
					//GAMMACMP
					15 01 00 00 00 00 02 29 10
					15 01 00 00 00 00 02 2A 20
					15 01 00 00 00 00 02 2B 30
					//CABC_PWM_UI
					15 01 00 00 00 00 02 30 F7
					15 01 00 00 00 00 02 31 F5
					15 01 00 00 00 00 02 32 F2
					15 01 00 00 00 00 02 33 EF
					15 01 00 00 00 00 02 34 EE
					15 01 00 00 00 00 02 35 ED
					15 01 00 00 00 00 02 36 E9
					15 01 00 00 00 00 02 37 E6
					15 01 00 00 00 00 02 38 E5
					15 01 00 00 00 00 02 39 E4
					15 01 00 00 00 00 02 3A E3
					15 01 00 00 00 00 02 3B E2
					15 01 00 00 00 00 02 3D E0
					15 01 00 00 00 00 02 3F DE
					15 01 00 00 00 00 02 40 DC
					15 01 00 00 00 00 02 41 D9
					//CABC_PWM
					15 01 00 00 00 00 02 45 E5
					15 01 00 00 00 00 02 46 DC
					15 01 00 00 00 00 02 47 D4
					15 01 00 00 00 00 02 48 CE
					15 01 00 00 00 00 02 49 CD
					15 01 00 00 00 00 02 4A CC
					15 01 00 00 00 00 02 4B C5
					15 01 00 00 00 00 02 4C BF
					15 01 00 00 00 00 02 4D BE
					15 01 00 00 00 00 02 4E BB
					15 01 00 00 00 00 02 4F B7
					15 01 00 00 00 00 02 50 B4
					15 01 00 00 00 00 02 51 B1
					15 01 00 00 00 00 02 52 AE
					15 01 00 00 00 00 02 53 AA
					15 01 00 00 00 00 02 54 A5
					//CABC_PWM_MOV
					15 01 00 00 00 00 02 58 D9
					15 01 00 00 00 00 02 59 D2
					15 01 00 00 00 00 02 5A CA
					15 01 00 00 00 00 02 5B C1
					15 01 00 00 00 00 02 5C BF
					15 01 00 00 00 00 02 5D BD
					15 01 00 00 00 00 02 5E B2
					15 01 00 00 00 00 02 5F A7
					15 01 00 00 00 00 02 60 A4
					15 01 00 00 00 00 02 61 9E
					15 01 00 00 00 00 02 62 98
					15 01 00 00 00 00 02 63 92
					15 01 00 00 00 00 02 64 8C
					15 01 00 00 00 00 02 65 84
					15 01 00 00 00 00 02 66 7C
					15 01 00 00 00 00 02 67 72
					//CMD Page Select: CMD1--Basic Display Control
					15 01 00 00 08 00 02 FF 10
					15 01 00 00 00 00 02 FB 01   //01--don't reload CMD1
					15 01 00 00 00 00 02 35 00   //open TE
					15 01 00 00 00 00 02 53 24   //enable BL
					05 01 00 00 64 00 02 11 00   //120ms change to 100ms>100ms
					05 01 00 00 0a 00 02 29 00]; //40ms change to 10ms>5ms
				qcom,mdss-dsi-off-command = [
					05 01 00 00 22 00 02 28 00
					05 01 00 00 40 00 02 10 00]; // 100ms change to 64ms>60ms
				qcom,mdss-dsi-cabc-off-command = [
					15 01 00 00 00 00 02 55 00]; //00--Off mode
				qcom,mdss-dsi-cabc-ui-command = [
					15 01 00 00 00 00 02 55 01]; //01--UI mode
				qcom,mdss-dsi-cabc-still-image-command = [
					15 01 00 00 00 00 02 55 02]; //02--Still mode
				qcom,mdss-dsi-cabc-video-command = [
					15 01 00 00 00 00 02 55 03]; //03--Moving mode
				qcom,mdss-dsi-hbm-on-command = [
					39 01 00 00 00 00 03 51 07 AD]; //12bits--3931,11bits--3931/2--1965
				qcom,mdss-dsi-hbm-off-command = [
					39 01 00 00 00 00 03 51 06 66]; //12bits--3276,11bits--3276/2
				qcom,mdss-dsi-normal-hbm-on-command = [
					39 01 00 00 00 00 03 51 07 FF]; //12bits--4095,11bits--2047

				qcom,mdss-dsi-on-command-state = "dsi_lp_mode";
				qcom,mdss-dsi-off-command-state = "dsi_lp_mode";
				qcom,mdss-dsi-cabc-off-command-state = "dsi_lp_mode";
				qcom,mdss-dsi-cabc-ui-command-state = "dsi_lp_mode";
				qcom,mdss-dsi-cabc-still-image-command-state = "dsi_lp_mode";
				qcom,mdss-dsi-cabc-video-command-state = "dsi_lp_mode";
				qcom,mdss-dsi-hbm-on-command-state = "dsi_lp_mode";
				qcom,mdss-dsi-hbm-off-command-state = "dsi_lp_mode";
				qcom,mdss-dsi-normal-hbm-on-command-state = "dsi_lp_mode";
			};
		};
	};
};
