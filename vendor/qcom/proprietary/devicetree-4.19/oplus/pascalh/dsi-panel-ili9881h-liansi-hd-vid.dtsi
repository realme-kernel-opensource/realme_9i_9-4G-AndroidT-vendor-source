&mdss_mdp {
	dsi_ili9881h_liansi_video: qcom,mdss_dsi_ili9881h_liansi_video {
		qcom,mdss-dsi-panel-name =
			"ili9881h video mode dsi liansi panel";
		qcom,mdss-dsi-panel-type = "dsi_video_mode";

		qcom,dsi-ctrl-num = <0>;
		qcom,dsi-phy-num = <0>;

		qcom,mdss-dsi-virtual-channel-id = <0>;
		qcom,mdss-dsi-stream = <0>;
		qcom,mdss-dsi-h-left-border = <0>;
		qcom,mdss-dsi-h-right-border = <0>;
		qcom,mdss-dsi-v-top-border = <0>;
		qcom,mdss-dsi-v-bottom-border = <0>;
		qcom,mdss-dsi-bpp = <24>;
		qcom,mdss-dsi-color-order = "rgb_swap_rgb";
		qcom,mdss-dsi-underflow-color = <0xff>;
		qcom,mdss-dsi-border-color = <0>;
		qcom,mdss-dsi-h-sync-pulse = <0>;
		qcom,mdss-dsi-traffic-mode = "non_burst_sync_event";
		qcom,mdss-dsi-lane-map = "lane_map_012";
		qcom,mdss-dsi-bllp-eof-power-mode;
		qcom,mdss-dsi-bllp-power-mode;
		qcom,mdss-dsi-tx-eot-append;
		qcom,mdss-dsi-lane-0-state;
		qcom,mdss-dsi-lane-1-state;
		qcom,mdss-dsi-lane-2-state;
		qcom,mdss-dsi-dma-trigger = "trigger_sw";
		qcom,mdss-dsi-mdp-trigger = "none";
		qcom,mdss-dsi-lp11-init;
		qcom,mdss-dsi-bl-pmic-control-type = "bl_ctrl_dcs";
		qcom,mdss-dsi-bl-min-level = <1>;
		qcom,mdss-dsi-bl-max-level = <4095>;
		qcom,mdss-brightness-max-level = <4095>;      //for  /sys/class/backlight/panel0-backlight/max_brightness
		qcom,mdss-dsi-bl-normal-max-level  = <2047>;  //for /sys/kernel/oplus_display/max_brightness
                oplus,dsi-brightness-remapping = <1 1>,
                                                 <2 2>,
                                                 <1023 1023>,
                                                 <2047 2047>;

		qcom,mdss-dsi-reset-sequence = <1 10>, <0 10>, <1 10>;
		qcom,mdss-pan-physical-width-dimension = <68>;
		qcom,mdss-pan-physical-height-dimension = <151>;

		qcom,mdss-dsi-display-timings {
			timing@0 {
				qcom,mdss-dsi-panel-width = <720>;
				qcom,mdss-dsi-panel-height = <1600>;
				qcom,mdss-dsi-h-front-porch = <18>;
				qcom,mdss-dsi-h-back-porch = <32>;
				qcom,mdss-dsi-h-pulse-width = <8>;
				qcom,mdss-dsi-h-sync-skew = <0>;
				qcom,mdss-dsi-v-back-porch = <16>;
				qcom,mdss-dsi-v-front-porch = <245>;
				qcom,mdss-dsi-v-pulse-width = <2>;
				qcom,mdss-dsi-panel-framerate = <60>;
				qcom,mdss-dsi-on-command = [39 01 00 00 00 00 04 FF 98 81 01
					39 01 00 00 00 00 02 00 44
					39 01 00 00 00 00 02 01 13
					39 01 00 00 00 00 02 02 10
					39 01 00 00 00 00 02 03 20
					39 01 00 00 00 00 02 04 CA
					39 01 00 00 00 00 02 05 13
					39 01 00 00 00 00 02 06 10
					39 01 00 00 00 00 02 07 20
					39 01 00 00 00 00 02 08 82
					39 01 00 00 00 00 02 09 09
					39 01 00 00 00 00 02 0A B3
					39 01 00 00 00 00 02 0B 00
					39 01 00 00 00 00 02 0C 17
					39 01 00 00 00 00 02 0D 17
					39 01 00 00 00 00 02 0E 04
					39 01 00 00 00 00 02 0F 04
					39 01 00 00 00 00 02 10 0A
					39 01 00 00 00 00 02 11 0A
					39 01 00 00 00 00 02 12 09
					39 01 00 00 00 00 02 1E 0A
					39 01 00 00 00 00 02 1F 0A
					39 01 00 00 00 00 02 16 82
					39 01 00 00 00 00 02 17 09
					39 01 00 00 00 00 02 18 33
					39 01 00 00 00 00 02 19 00
					39 01 00 00 00 00 02 1A 17
					39 01 00 00 00 00 02 1B 17
					39 01 00 00 00 00 02 1C 04
					39 01 00 00 00 00 02 1D 04
					39 01 00 00 00 00 02 20 09
					39 01 00 00 00 00 02 24 02
					39 01 00 00 00 00 02 25 0B
					39 01 00 00 00 00 02 26 10
					39 01 00 00 00 00 02 27 20
                    39 01 00 00 00 00 02 2C 34
					39 01 00 00 00 00 02 31 07
					39 01 00 00 00 00 02 32 2A
					39 01 00 00 00 00 02 33 2A
					39 01 00 00 00 00 02 34 0D
					39 01 00 00 00 00 02 35 28
					39 01 00 00 00 00 02 36 29
					39 01 00 00 00 00 02 37 11
					39 01 00 00 00 00 02 38 13
					39 01 00 00 00 00 02 39 15
					39 01 00 00 00 00 02 3A 17
					39 01 00 00 00 00 02 3B 19
					39 01 00 00 00 00 02 3C 1B
					39 01 00 00 00 00 02 3D 09
					39 01 00 00 00 00 02 3E 07
					39 01 00 00 00 00 02 3F 07
					39 01 00 00 00 00 02 40 07
					39 01 00 00 00 00 02 41 07
					39 01 00 00 00 00 02 42 07
					39 01 00 00 00 00 02 43 07
					39 01 00 00 00 00 02 44 07
					39 01 00 00 00 00 02 45 07
					39 01 00 00 00 00 02 46 07
					39 01 00 00 00 00 02 47 07
					39 01 00 00 00 00 02 48 2A
					39 01 00 00 00 00 02 49 2A
					39 01 00 00 00 00 02 4A 0C
					39 01 00 00 00 00 02 4B 28
					39 01 00 00 00 00 02 4C 29
					39 01 00 00 00 00 02 4D 10
					39 01 00 00 00 00 02 4E 12
					39 01 00 00 00 00 02 4F 14
					39 01 00 00 00 00 02 50 16
					39 01 00 00 00 00 02 51 18
					39 01 00 00 00 00 02 52 1A
					39 01 00 00 00 00 02 53 08
					39 01 00 00 00 00 02 54 07
					39 01 00 00 00 00 02 55 07
					39 01 00 00 00 00 02 56 07
					39 01 00 00 00 00 02 57 07
					39 01 00 00 00 00 02 58 07
					39 01 00 00 00 00 02 59 07
					39 01 00 00 00 00 02 5A 07
					39 01 00 00 00 00 02 5B 07
					39 01 00 00 00 00 02 5C 07
					39 01 00 00 00 00 02 61 07
					39 01 00 00 00 00 02 62 2A
					39 01 00 00 00 00 02 63 2A
					39 01 00 00 00 00 02 64 0D
					39 01 00 00 00 00 02 65 28
					39 01 00 00 00 00 02 66 29
					39 01 00 00 00 00 02 67 11
					39 01 00 00 00 00 02 68 13
					39 01 00 00 00 00 02 69 15
					39 01 00 00 00 00 02 6A 17
					39 01 00 00 00 00 02 6B 19
					39 01 00 00 00 00 02 6C 1B
					39 01 00 00 00 00 02 6D 09
					39 01 00 00 00 00 02 6E 07
					39 01 00 00 00 00 02 6F 07
					39 01 00 00 00 00 02 70 07
					39 01 00 00 00 00 02 71 07
					39 01 00 00 00 00 02 72 07
					39 01 00 00 00 00 02 73 07
					39 01 00 00 00 00 02 74 07
					39 01 00 00 00 00 02 75 07
					39 01 00 00 00 00 02 76 07
					39 01 00 00 00 00 02 77 07
					39 01 00 00 00 00 02 78 2A
					39 01 00 00 00 00 02 79 2A
					39 01 00 00 00 00 02 7A 0C
					39 01 00 00 00 00 02 7B 28
					39 01 00 00 00 00 02 7C 29
					39 01 00 00 00 00 02 7D 10
					39 01 00 00 00 00 02 7E 12
					39 01 00 00 00 00 02 7F 14
					39 01 00 00 00 00 02 80 16
					39 01 00 00 00 00 02 81 18
					39 01 00 00 00 00 02 82 1A
					39 01 00 00 00 00 02 83 08
					39 01 00 00 00 00 02 84 07
					39 01 00 00 00 00 02 85 07
					39 01 00 00 00 00 02 86 07
					39 01 00 00 00 00 02 87 07
					39 01 00 00 00 00 02 88 07
					39 01 00 00 00 00 02 89 07
					39 01 00 00 00 00 02 8A 07
					39 01 00 00 00 00 02 8B 07
					39 01 00 00 00 00 02 8C 07
					39 01 00 00 00 00 02 A0 01
					39 01 00 00 00 00 02 A2 00
					39 01 00 00 00 00 02 A3 00
					39 01 00 00 00 00 02 A4 00
					39 01 00 00 00 00 02 A5 00
					39 01 00 00 00 00 02 A6 00
					39 01 00 00 00 00 02 A7 05
					39 01 00 00 00 00 02 A8 05
					39 01 00 00 00 00 02 A9 04
					39 01 00 00 00 00 02 AA 04
					39 01 00 00 00 00 02 AB 05
					39 01 00 00 00 00 02 AC 05
					39 01 00 00 00 00 02 AD 04
					39 01 00 00 00 00 02 AE 04
                                        39 01 00 00 00 00 02 B0 33
					39 01 00 00 00 00 02 B1 33
					39 01 00 00 00 00 02 B2 00
					39 01 00 00 00 00 02 B9 40
					39 01 00 00 00 00 02 C3 FF
					39 01 00 00 00 00 02 CA 44
					39 01 00 00 00 00 02 D0 01
					39 01 00 00 00 00 02 D1 00
					39 01 00 00 00 00 02 DC 37
					39 01 00 00 00 00 02 DD 42
					39 01 00 00 00 00 02 E2 00
					39 01 00 00 00 00 02 E6 23
					39 01 00 00 00 00 02 E7 54
					39 01 00 00 00 00 02 ED 00
					39 01 00 00 00 00 04 FF 98 81 02
					39 01 00 00 00 00 02 4B 5A
					39 01 00 00 00 00 02 06 90
					39 01 00 00 00 00 02 01 10
					39 01 00 00 00 00 02 4D 4E
                                        39 01 00 00 00 00 02 4E 00
					39 01 00 00 00 00 02 1A 48
					39 01 00 00 00 00 02 52 48
					39 01 00 00 00 00 02 57 48
					39 01 00 00 00 00 04 FF 98 81 05
					39 01 00 00 00 00 02 03 01
					39 01 00 00 00 00 02 04 24
					39 01 00 00 00 00 02 63 9C
					39 01 00 00 00 00 02 64 9C
					39 01 00 00 00 00 02 68 8F
					39 01 00 00 00 00 02 69 95
					39 01 00 00 00 00 02 6A CB
					39 01 00 00 00 00 02 6B BD
                                        39 01 00 00 00 00 02 E0 03
					39 01 00 00 00 00 02 85 7F
					39 01 00 00 00 00 02 E5 6D
					39 01 00 00 00 00 02 E6 40
					39 01 00 00 00 00 02 E7 D8
					39 01 00 00 00 00 02 E8 D8
					39 01 00 00 00 00 02 E9 A5
					39 01 00 00 00 00 02 C0 01
                                        39 01 00 00 00 00 02 C1 00
					39 01 00 00 00 00 02 C2 01
					39 01 00 00 00 00 02 C3 00
					39 01 00 00 00 00 02 C4 01
					39 01 00 00 00 00 02 C5 00
					39 01 00 00 00 00 02 C6 01
					39 01 00 00 00 00 02 C7 00
					39 01 00 00 00 00 02 C8 8F
                                        39 01 00 00 00 00 02 C9 8F
					39 01 00 00 00 00 02 CA 53
					39 01 00 00 00 00 02 CB 53
					39 01 00 00 00 00 02 CC CB
					39 01 00 00 00 00 02 CD CB
					39 01 00 00 00 00 02 CE CB
					39 01 00 00 00 00 02 CF CB
					39 01 00 00 00 00 02 D0 95
                                        39 01 00 00 00 00 02 D1 95
					39 01 00 00 00 00 02 D2 59
					39 01 00 00 00 00 02 D3 59
					39 01 00 00 00 00 02 D4 BD
					39 01 00 00 00 00 02 D5 BD
					39 01 00 00 00 00 02 D6 BD
					39 01 00 00 00 00 02 D7 BD
					39 01 00 00 00 00 04 FF 98 81 06
					39 01 00 00 00 00 02 D3 09
					39 01 00 00 00 00 02 D6 87
					39 01 00 00 00 00 02 27 FF
					39 01 00 00 00 00 02 28 20
					39 01 00 00 00 00 02 2E 01
					39 01 00 00 00 00 02 C0 1F
					39 01 00 00 00 00 02 C1 03
					39 01 00 00 00 00 02 C2 04
					39 01 00 00 00 00 02 7C 40
					39 01 00 00 00 00 02 DD 10
					39 01 00 00 00 00 04 FF 98 81 08
					39 01 00 00 00 00 1C E0 00 1A 81 B9 FB 55 2E 55 82 A6 A9 DC 07 2D 51 AA 77 A7 C6 EF FF 11 3E 74 A1 03 E6
					39 01 00 00 00 00 1C E1 00 6D 81 B9 FB 55 2E 55 82 A6 A9 DC 07 2D 51 AA 77 A7 C6 EF FF 11 3E 74 A1 03 93
					39 01 00 00 00 00 04 FF 98 81 0E
					39 01 00 00 00 00 02 00 A0
					39 01 00 00 00 00 02 01 28
					39 01 00 00 00 00 02 02 10
                                        39 01 00 00 00 00 02 13 10
					39 01 00 00 00 00 02 41 50
                                        39 01 00 00 00 00 02 20 07
					39 01 00 00 00 00 02 29 BE
					39 01 00 00 00 00 02 25 0A
                                        39 01 00 00 00 00 02 26 23
					39 01 00 00 00 00 02 2D 95
					39 01 00 00 00 00 02 40 07
                                        39 01 00 00 00 00 02 49 BE
					39 01 00 00 00 00 02 45 0A
					39 01 00 00 00 00 02 46 23
                                        39 01 00 00 00 00 02 4D 96
                                        39 01 00 00 00 00 04 FF 98 81 07
					39 01 00 00 00 00 02 0F 02
					39 01 00 00 00 00 04 FF 98 81 06
					39 01 00 00 00 00 02 06 C4
					39 01 00 00 00 00 04 FF 98 81 03
					39 01 00 00 00 00 02 83 30
					39 01 00 00 00 00 02 84 00
					39 01 00 00 00 00 04 FF 98 81 00
					39 01 00 00 00 00 03 51 00 00
					39 01 00 00 00 00 02 53 2C
					39 01 00 00 00 00 03 68 04 00
					39 01 00 00 00 00 02 35 00
					05 01 00 00 78 00 01 11
					05 01 00 00 14 00 01 29
					];
				qcom,mdss-dsi-off-command = [
					39 01 00 00 00 00 04 FF 98 81 00
					05 01 00 00 14 00 02 28 00
					05 01 00 00 78 00 02 10 00];
				qcom,mdss-dsi-on-command-state = "dsi_lp_mode";
				qcom,mdss-dsi-off-command-state = "dsi_lp_mode";
			};
		};
	};
};
