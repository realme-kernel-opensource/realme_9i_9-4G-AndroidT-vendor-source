&mdss_mdp {
	dsi_ili9882n_cdot_video: qcom,mdss_dsi_ili9882n_cdot_video {
		qcom,mdss-dsi-panel-name =
			"RA511_CDO_AU_IL_00";
		qcom,mdss-dsi-panel-type = "dsi_video_mode";

		qcom,dsi-ctrl-num = <0>;
		qcom,dsi-phy-num = <0>;

		qcom,mdss-dsi-virtual-channel-id = <0>;
		qcom,mdss-dsi-stream = <0>;
		qcom,mdss-dsi-h-left-border = <0>;
		qcom,mdss-dsi-h-right-border = <0>;
		qcom,mdss-dsi-v-top-border = <0>;
		qcom,mdss-dsi-v-bottom-border = <0>;
		qcom,mdss-dsi-bpp = <24>;
		qcom,mdss-dsi-color-order = "rgb_swap_rgb";
		qcom,mdss-dsi-underflow-color = <0xff>;
		qcom,mdss-dsi-border-color = <0>;
		qcom,mdss-dsi-h-sync-pulse = <0>;
		qcom,mdss-dsi-traffic-mode = "non_burst_sync_event";
		qcom,mdss-dsi-lane-map = "lane_map_012";
		qcom,mdss-dsi-bllp-eof-power-mode;
		qcom,mdss-dsi-bllp-power-mode;
		qcom,mdss-dsi-tx-eot-append;
		qcom,mdss-dsi-lane-0-state;
		qcom,mdss-dsi-lane-1-state;
		qcom,mdss-dsi-lane-2-state;
		qcom,mdss-dsi-dma-trigger = "trigger_sw";
		qcom,mdss-dsi-mdp-trigger = "none";
		qcom,mdss-dsi-lp11-init;
		qcom,mdss-dsi-bl-pmic-control-type = "bl_ctrl_dcs";
		qcom,mdss-dsi-bl-min-level = <1>;
		qcom,mdss-dsi-bl-max-level = <4095>;
		qcom,mdss-brightness-max-level = <4095>;      //for  /sys/class/backlight/panel0-backlight/max_brightness
		qcom,mdss-dsi-bl-normal-max-level  = <2047>;  //for /sys/kernel/oplus_display/max_brightness
		qcom,mdss-brightness-normal-max-level = <2047>;  //for backlight caculation
		//qcom,mdss-brightness-default-level = <1024>;
                oplus,dsi-brightness-remapping = <1 1>,
                                                 <2 2>,
                                                 <1023 1023>,
                                                 <2047 2047>;

		qcom,mdss-dsi-reset-sequence = <1 10>, <0 10>, <1 10>;
		qcom,mdss-pan-physical-width-dimension = <68>;
		qcom,mdss-pan-physical-height-dimension = <151>;
		oplus,mdss-dsi-vendor-name = "ILI9882N";
		oplus,mdss-dsi-manufacture = "CDOT";

		qcom,mdss-dsi-display-timings {
			timing@0 {
				qcom,mdss-dsi-panel-width = <720>;
				qcom,mdss-dsi-panel-height = <1600>;
				qcom,mdss-dsi-h-front-porch = <86>;
				qcom,mdss-dsi-h-back-porch = <86>;
				qcom,mdss-dsi-h-pulse-width = <41>;
				qcom,mdss-dsi-h-sync-skew = <0>;
				qcom,mdss-dsi-v-back-porch = <16>;
				qcom,mdss-dsi-v-front-porch = <230>;
				qcom,mdss-dsi-v-pulse-width = <4>;
				qcom,mdss-dsi-panel-framerate = <60>;
				qcom,mdss-dsi-on-command = [
					39 01 00 00 00 00 04 FF 98 82 00
					05 01 00 00 78 00 01 11
					39 01 00 00 00 00 04 FF 98 82 06
					39 01 00 00 00 00 02 D6 55
					39 01 00 00 00 00 02 DD 61
					39 01 00 00 00 00 02 DC 68    //TE=TSHD
					39 01 00 00 00 00 02 06 A4    //OSC 64M
					39 01 00 00 00 00 04 FF 98 82 02
					39 01 00 00 00 00 02 06 8F    //Internal Line Time
					39 01 00 00 00 00 02 0B A0    //Internal VFP
					39 01 00 00 00 00 02 0C 00    //Internal VFP
					39 01 00 00 00 00 02 0D 14    //Internal VFP
					39 01 00 00 00 00 02 0E E6    //Internal VFP
					39 01 00 00 00 00 04 FF 98 82 03
					39 01 00 00 00 00 02 83 30    //11bits 31.25Khz
					39 01 00 00 00 00 02 84 00
					39 01 00 00 00 00 04 FF 98 82 00
					39 01 00 00 00 00 03 51 00 00
					39 01 00 00 00 00 02 53 2C
					39 01 00 00 00 00 03 68 04 00
					39 01 00 00 00 00 02 35 00
					05 01 00 00 14 00 01 29
					];
				qcom,mdss-dsi-off-command = [
					39 01 00 00 00 00 04 FF 98 82 00
					05 01 00 00 14 00 02 28 00
					05 01 00 00 78 00 02 10 00];
				qcom,mdss-dsi-cabc-off-command = [
					39 01 00 00 00 00 04 FF 98 82 00
					15 01 00 00 00 00 02 55 00];
				qcom,mdss-dsi-cabc-ui-command = [
					39 01 00 00 00 00 04 FF 98 82 03
					15 01 00 00 00 00 02 AC FA
					39 01 00 00 00 00 04 FF 98 82 00
					15 01 00 00 00 00 02 55 01];
				qcom,mdss-dsi-cabc-still-image-command = [
					39 01 00 00 00 00 04 FF 98 82 03
					15 01 00 00 00 00 02 AC E0
					39 01 00 00 00 00 04 FF 98 82 00
					15 01 00 00 00 00 02 55 02];
				qcom,mdss-dsi-cabc-video-command = [
					39 01 00 00 00 00 04 FF 98 82 03
					15 01 00 00 00 00 02 AC D8
					39 01 00 00 00 00 04 FF 98 82 00
					15 01 00 00 00 00 02 55 03];
				qcom,mdss-dsi-cabc-off-command-state = "dsi_hs_mode";
				qcom,mdss-dsi-cabc-ui-command-state = "dsi_hs_mode";
				qcom,mdss-dsi-cabc-still-image-command-state = "dsi_hs_mode";
				qcom,mdss-dsi-cabc-video-command-state = "dsi_hs_mode";
				qcom,mdss-dsi-on-command-state = "dsi_lp_mode";
				qcom,mdss-dsi-off-command-state = "dsi_lp_mode";
			};
		};
	};
};
