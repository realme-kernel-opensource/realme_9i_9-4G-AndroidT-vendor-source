&mdss_mdp {
	dsi_ili9881h_hlt_90hz_video: qcom,mdss_dsi_ili9881h_hlt_90hz_video {
		qcom,mdss-dsi-panel-name =
			"ili9881h video mode dsi hlt 90hz panel";
		qcom,mdss-dsi-panel-type = "dsi_video_mode";

		qcom,dsi-ctrl-num = <0>;
		qcom,dsi-phy-num = <0>;

		qcom,mdss-dsi-virtual-channel-id = <0>;
		qcom,mdss-dsi-stream = <0>;
		qcom,mdss-dsi-h-left-border = <0>;
		qcom,mdss-dsi-h-right-border = <0>;
		qcom,mdss-dsi-v-top-border = <0>;
		qcom,mdss-dsi-v-bottom-border = <0>;
		qcom,mdss-dsi-bpp = <24>;
		qcom,mdss-dsi-color-order = "rgb_swap_rgb";
		qcom,mdss-dsi-underflow-color = <0xff>;
		qcom,mdss-dsi-border-color = <0>;
		qcom,mdss-dsi-h-sync-pulse = <0>;
		qcom,mdss-dsi-traffic-mode = "non_burst_sync_event";
		qcom,mdss-dsi-lane-map = "lane_map_0123";
		qcom,mdss-dsi-bllp-eof-power-mode;
		qcom,mdss-dsi-bllp-power-mode;
		qcom,ulps-enabled;
		qcom,suspend-ulps-enabled;
		qcom,mdss-dsi-tx-eot-append;
		qcom,mdss-dsi-lane-0-state;
		qcom,mdss-dsi-lane-1-state;
		qcom,mdss-dsi-lane-2-state;
		qcom,mdss-dsi-lane-3-state;
		qcom,mdss-dsi-dma-trigger = "trigger_sw";
		qcom,mdss-dsi-mdp-trigger = "none";
		qcom,mdss-dsi-lp11-init;
		qcom,mdss-dsi-bl-pmic-control-type = "bl_ctrl_dcs";
		qcom,mdss-dsi-bl-min-level = <1>;
		qcom,mdss-dsi-bl-max-level = <4095>;
		qcom,mdss-brightness-max-level = <4095>;
		qcom,mdss-dsi-bl-normal-max-level = <2047>;
		qcom,mdss-brightness-normal-max-level = <2047>;
		qcom,mdss-brightness-default-level = <1024>;
                oplus,dsi-brightness-remapping = <1 1>,
                                                 <3 3>,
                                                 <4 5>,
                                                 <2047 3052>,
                                                 <4095 4095>;

		qcom,mdss-dsi-reset-sequence = <1 2>, <0 2>, <1 10>;
		qcom,mdss-pan-physical-width-dimension = <68>;
		qcom,mdss-pan-physical-height-dimension = <151>;
		oplus,mdss-dsi-vendor-name = "ILI9881H";
		oplus,mdss-dsi-manufacture = "HELITAI";

		qcom,mdss-dsi-display-timings {
			timing@0 {
				qcom,mdss-dsi-panel-width = <720>;
				qcom,mdss-dsi-panel-height = <1600>;
				qcom,mdss-dsi-h-front-porch = <40>;
				qcom,mdss-dsi-h-back-porch = <20>;
				qcom,mdss-dsi-h-pulse-width = <8>;
				qcom,mdss-dsi-h-sync-skew = <0>;
				qcom,mdss-dsi-v-back-porch = <20>;
				qcom,mdss-dsi-v-front-porch = <340>;
				qcom,mdss-dsi-v-pulse-width = <8>;
				qcom,mdss-dsi-panel-framerate = <90>;
				qcom,mdss-dsi-on-command = [
					39 01 00 00 00 00 04 FF 98 81 06
					15 01 00 00 00 00 02 06 C4
					39 01 00 00 00 00 04 FF 98 81 03
					15 01 00 00 00 00 02 83 20
					15 01 00 00 00 00 02 84 00       //PWM 12BIT, 17.5K
					15 01 00 00 00 00 02 90 11       //CABC begin
					15 01 00 00 00 00 02 91 F4
					15 01 00 00 00 00 02 92 14
					15 01 00 00 00 00 02 93 15
					15 01 00 00 00 00 02 94 0B
					15 01 00 00 00 00 02 95 0C
					15 01 00 00 00 00 02 96 0D
					15 01 00 00 00 00 02 97 0D
					15 01 00 00 00 00 02 98 0E
					15 01 00 00 00 00 02 99 0E
					15 01 00 00 00 00 02 9A 0E
					15 01 00 00 00 00 02 9B 10
					15 01 00 00 00 00 02 9C 11
					15 01 00 00 00 00 02 9D 12
					15 01 00 00 00 00 02 9E 04
					15 01 00 00 00 00 02 9F 06
					15 01 00 00 00 00 02 A0 08
					15 01 00 00 00 00 02 A1 0A
					15 01 00 00 00 00 02 A2 0C
					15 01 00 00 00 00 02 A3 0C
					15 01 00 00 00 00 02 A4 0C
					15 01 00 00 00 00 02 A5 0E
					15 01 00 00 00 00 02 A6 90
					15 01 00 00 00 00 02 A7 91
					15 01 00 00 00 00 02 AF AF
					15 01 00 00 00 00 02 AE B9
					15 01 00 00 00 00 02 AD EF
					15 01 00 00 00 00 02 89 B0
					15 01 00 00 00 00 02 AC FA       //CABC end
					39 01 00 00 00 00 04 FF 98 81 00
					15 01 00 00 00 00 02 53 24       //PWM function enable
					15 01 00 00 00 00 02 55 01
					39 01 00 00 00 00 04 FF 98 81 00
					15 01 00 00 00 00 02 35 00
					05 01 00 00 3E 00 02 11 00       //delay 62ms
					39 01 00 00 00 00 04 FF 98 81 06
					15 01 00 00 00 00 02 58 C8
					39 01 00 00 00 00 04 FF 98 81 00
					05 01 00 00 02 00 02 29 00];     //delay 2ms
				qcom,mdss-dsi-off-command = [
					39 01 00 00 00 00 04 FF 98 81 00
					05 01 00 00 14 00 02 28 00
					05 01 00 00 78 00 02 10 00];

				qcom,mdss-dsi-cabc-off-command = [
					15 01 00 00 00 00 02 55 00];
				qcom,mdss-dsi-cabc-ui-command = [
					39 01 00 00 00 00 04 FF 98 81 03
					15 01 00 00 00 00 02 AC FA
					39 01 00 00 00 00 04 FF 98 81 00
					15 01 00 00 00 00 02 55 01];
				qcom,mdss-dsi-cabc-still-image-command = [
					39 01 00 00 00 00 04 FF 98 81 03
					15 01 00 00 00 00 02 AC E0
					39 01 00 00 00 00 04 FF 98 81 00
					15 01 00 00 00 00 02 55 02];
				qcom,mdss-dsi-cabc-video-command = [
					39 01 00 00 00 00 04 FF 98 81 03
					15 01 00 00 00 00 02 AC D8
					39 01 00 00 00 00 04 FF 98 81 00
					15 01 00 00 00 00 02 55 03];
				qcom,mdss-dsi-cabc-off-command-state = "dsi_hs_mode";
				qcom,mdss-dsi-cabc-ui-command-state = "dsi_hs_mode";
				qcom,mdss-dsi-cabc-still-image-command-state = "dsi_hs_mode";
				qcom,mdss-dsi-cabc-video-command-state = "dsi_hs_mode";
				qcom,mdss-dsi-on-command-state = "dsi_lp_mode";
				qcom,mdss-dsi-off-command-state = "dsi_lp_mode";
			};
		};
	};
};
