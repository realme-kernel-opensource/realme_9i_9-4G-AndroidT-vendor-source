&mdss_mdp {
	dsi_nt36672c_tianma_fhd_video: qcom,mdss_dsi_nt36672c_tianma_fhd_video {
		qcom,mdss-dsi-panel-name =
			"nt36672c video mode dsi fhd panel";
		qcom,mdss-dsi-panel-type = "dsi_video_mode";

		qcom,dsi-ctrl-num = <0>;
		qcom,dsi-phy-num = <0>;
		qcom,mdss-dsi-virtual-channel-id = <0>;
		qcom,mdss-dsi-stream = <0>;
		qcom,mdss-dsi-h-left-border = <0>;
		qcom,mdss-dsi-h-right-border = <0>;
		qcom,mdss-dsi-v-top-border = <0>;
		qcom,mdss-dsi-v-bottom-border = <0>;
		qcom,mdss-dsi-bpp = <24>;
		qcom,mdss-dsi-color-order = "rgb_swap_rgb";
		qcom,mdss-dsi-underflow-color = <0xff>;
		qcom,mdss-dsi-border-color = <0>;
		qcom,mdss-dsi-h-sync-pulse = <0>;
		qcom,mdss-dsi-traffic-mode = "non_burst_sync_event";
		qcom,mdss-dsi-lane-map = "lane_map_0123";
		qcom,mdss-dsi-bllp-eof-power-mode;
		qcom,mdss-dsi-bllp-power-mode;
		qcom,mdss-dsi-tx-eot-append;
		qcom,mdss-dsi-lane-0-state;
		qcom,mdss-dsi-lane-1-state;
		qcom,mdss-dsi-lane-2-state;
		qcom,mdss-dsi-lane-3-state;
		qcom,mdss-dsi-dma-trigger = "trigger_sw";
		qcom,mdss-dsi-mdp-trigger = "none";
		qcom,mdss-dsi-lp11-init;
		//qcom,mdss-dsi-bl-pmic-control-type = "bl_ctrl_dcs";
		qcom,mdss-dsi-bl-min-level = <1>;
		qcom,mdss-dsi-bl-normal-max-level = <3383>;
		qcom,mdss-dsi-bl-max-level = <4095>;
		qcom,mdss-brightness-normal-max-level = <3383>;
		qcom,mdss-brightness-max-level = <4095>;
		qcom,mdss-brightness-default-level = <400>;
		qcom,mdss-dsi-reset-sequence = <1 10>, <0 10>, <1 10>;
		qcom,mdss-pan-physical-width-dimension = <71>;
		qcom,mdss-pan-physical-height-dimension = <152>;
		oplus,mdss-dsi-vendor-name = "NT36672C-90HZ";
		oplus,mdss-dsi-manufacture = "NT36672C";
		qcom,mdss-dsi-display-timings {
			timing@0 {
				qcom,mdss-dsi-video-mode;
				qcom,mdss-dsi-panel-clockrate = <1107000000>;
				qcom,mdss-dsi-panel-width = <1080>;
				qcom,mdss-dsi-panel-height = <2412>;
				qcom,mdss-dsi-h-front-porch = <223>;
				qcom,mdss-dsi-h-back-porch = <222>;
				qcom,mdss-dsi-h-pulse-width = <20>;
				qcom,mdss-dsi-h-sync-skew = <0>;
				qcom,mdss-dsi-v-back-porch = <10>;
				qcom,mdss-dsi-v-front-porch = <54>;
				qcom,mdss-dsi-v-pulse-width = <10>;
				qcom,mdss-dsi-panel-framerate = <90>;
				qcom,mdss-dsi-on-command = [
					39 01 00 00 00 00 02 FF 10
					39 01 00 00 00 00 02 FB 01
					39 01 00 00 00 00 06 3B 03 14 36 04 04
					39 01 00 00 00 00 02 B0 00
					//39 01 00 00 00 00 02 C0 00
					39 01 00 00 00 00 11 C1 89 28 00 0C 00 AA 02 0E 00 43 00 07 08 BB 08 7A
					39 01 00 00 00 00 03 C2 1B A0

					39 01 00 00 00 00 02 FF 20
					39 01 00 00 00 00 02 FB 01
					39 01 00 00 00 00 02 01 66
					39 01 00 00 00 00 02 06 64
					39 01 00 00 00 00 02 07 28
					39 01 00 00 00 00 02 17 66
					39 01 00 00 00 00 02 1B 01
					39 01 00 00 00 00 02 5C 90
					39 01 00 00 00 00 02 5E B6
					39 01 00 00 00 00 02 69 D0
					39 01 00 00 00 00 02 89 0D
					39 01 00 00 00 00 02 8A 0D
					39 01 00 00 00 00 02 95 D1
					39 01 00 00 00 00 02 96 D1
					39 01 00 00 00 00 02 F2 66
					39 01 00 00 00 00 02 F3 54
					39 01 00 00 00 00 02 F4 66
					39 01 00 00 00 00 02 F5 54
					39 01 00 00 00 00 02 F6 66
					39 01 00 00 00 00 02 F7 54
					39 01 00 00 00 00 02 F8 66
					39 01 00 00 00 00 02 F9 54

					29 01 00 00 00 00 02 FF 23
					29 01 00 00 00 00 02 FB 01
					29 01 00 00 00 00 02 00 80
					29 01 00 00 00 00 02 05 22
					29 01 00 00 00 00 02 06 01
					29 01 00 00 00 00 02 07 00
					29 01 00 00 00 00 02 08 01
					29 01 00 00 00 00 02 09 00
					29 01 00 00 00 00 02 10 82
					29 01 00 00 00 00 02 11 01
					29 01 00 00 00 00 02 12 95
					29 01 00 00 00 00 02 15 68
					29 01 00 00 00 00 02 16 0B

					39 01 00 00 00 00 02 FF 24
					39 01 00 00 00 00 02 FB 01
					39 01 00 00 00 00 02 03 13
					39 01 00 00 00 00 02 04 15
					39 01 00 00 00 00 02 05 17
					39 01 00 00 00 00 02 09 26
					39 01 00 00 00 00 02 0A 27
					39 01 00 00 00 00 02 0B 28
					39 01 00 00 00 00 02 0C 24
					39 01 00 00 00 00 02 0D 01
					39 01 00 00 00 00 02 0E 2F
					39 01 00 00 00 00 02 0F 2D
					39 01 00 00 00 00 02 10 2E
					39 01 00 00 00 00 02 11 2C
					39 01 00 00 00 00 02 12 8B
					39 01 00 00 00 00 02 13 8C
					39 01 00 00 00 00 02 16 0F
					39 01 00 00 00 00 02 17 22
					39 01 00 00 00 00 02 1B 13
					39 01 00 00 00 00 02 1C 15
					39 01 00 00 00 00 02 1D 17
					39 01 00 00 00 00 02 21 26
					39 01 00 00 00 00 02 22 27
					39 01 00 00 00 00 02 23 28
					39 01 00 00 00 00 02 24 24
					39 01 00 00 00 00 02 25 01
					39 01 00 00 00 00 02 26 2F
					39 01 00 00 00 00 02 27 2D
					39 01 00 00 00 00 02 28 2E
					39 01 00 00 00 00 02 29 2C
					39 01 00 00 00 00 02 2A 8B
					39 01 00 00 00 00 02 2B 8C
					39 01 00 00 00 00 02 30 0F
					39 01 00 00 00 00 02 31 22
					39 01 00 00 00 00 02 32 00
					39 01 00 00 00 00 02 33 03
					39 01 00 00 00 00 02 35 01
					39 01 00 00 00 00 02 36 01
					39 01 00 00 00 00 02 4E 32
					39 01 00 00 00 00 02 4F 33
					39 01 00 00 00 00 02 53 32
					39 01 00 00 00 00 02 71 28
					39 01 00 00 00 00 02 77 80
					39 01 00 00 00 00 02 79 04
					39 01 00 00 00 00 02 7A 02
					39 01 00 00 00 00 02 7B 8E
					39 01 00 00 00 00 02 7D 03
					39 01 00 00 00 00 02 80 03
					39 01 00 00 00 00 02 81 03
					39 01 00 00 00 00 02 82 13
					39 01 00 00 00 00 02 84 31
					39 01 00 00 00 00 02 85 13
					39 01 00 00 00 00 02 86 22
					39 01 00 00 00 00 02 87 31
					39 01 00 00 00 00 02 90 13
					39 01 00 00 00 00 02 92 31
					39 01 00 00 00 00 02 93 13
					39 01 00 00 00 00 02 94 22
					39 01 00 00 00 00 02 95 31
					39 01 00 00 00 00 02 9C F4
					39 01 00 00 00 00 02 9D 01
					39 01 00 00 00 00 02 A0 0E
					39 01 00 00 00 00 02 A2 0E
					39 01 00 00 00 00 02 A3 02
					39 01 00 00 00 00 02 A4 03
					39 01 00 00 00 00 02 A5 03
					39 01 00 00 00 00 02 C4 40
					39 01 00 00 00 00 02 C6 C0
					39 01 00 00 00 00 02 C9 00
					39 01 00 00 00 00 02 D9 80
					39 01 00 00 00 00 02 E9 02

					39 01 00 00 00 00 02 FF 25
					39 01 00 00 00 00 02 FB 01
					39 01 00 00 00 00 02 0F 1B
					39 01 00 00 00 00 02 18 21
					39 01 00 00 00 00 02 19 E4
					39 01 00 00 00 00 02 20 00
					39 01 00 00 00 00 02 21 40
					39 01 00 00 00 00 02 66 40
					39 01 00 00 00 00 02 67 29
					39 01 00 00 00 00 02 68 50
					39 01 00 00 00 00 02 69 60
					39 01 00 00 00 00 02 6B 00
					39 01 00 00 00 00 02 71 6D
					39 01 00 00 00 00 02 77 60
					39 01 00 00 00 00 02 78 A5
					39 01 00 00 00 00 02 7D 40
					39 01 00 00 00 00 02 7E 2D
					39 01 00 00 00 00 02 C0 4D
					39 01 00 00 00 00 02 C1 A9
					39 01 00 00 00 00 02 C2 D2
					39 01 00 00 00 00 02 C4 11
					39 01 00 00 00 00 02 D6 80
					39 01 00 00 00 00 02 D7 82
					39 01 00 00 00 00 02 DA 02
					39 01 00 00 00 00 02 DD 02
					39 01 00 00 00 00 02 E0 02
					39 01 00 00 00 00 02 F0 00
					39 01 00 00 00 00 02 F1 04

					39 01 00 00 00 00 02 FF 26
					39 01 00 00 00 00 02 FB 01
					39 01 00 00 00 00 02 00 10
					39 01 00 00 00 00 02 01 EB
					39 01 00 00 00 00 02 03 00
					39 01 00 00 00 00 02 04 EB
					39 01 00 00 00 00 02 05 08
					39 01 00 00 00 00 02 06 0F
					39 01 00 00 00 00 02 08 0F
					39 01 00 00 00 00 02 14 06
					39 01 00 00 00 00 02 15 01
					39 01 00 00 00 00 02 74 AF
					39 01 00 00 00 00 02 81 0D
					39 01 00 00 00 00 02 83 02
					39 01 00 00 00 00 02 84 03
					39 01 00 00 00 00 02 85 01
					39 01 00 00 00 00 02 86 03
					39 01 00 00 00 00 02 87 01
					39 01 00 00 00 00 02 88 06
					39 01 00 00 00 00 02 8A 1A
					39 01 00 00 00 00 02 8B 11
					39 01 00 00 00 00 02 8C 24
					39 01 00 00 00 00 02 8E 42
					39 01 00 00 00 00 02 8F 11
					39 01 00 00 00 00 02 90 11
					39 01 00 00 00 00 02 91 11
					39 01 00 00 00 00 02 9A 80
					39 01 00 00 00 00 02 9B 04
					39 01 00 00 00 00 02 9C 00
					39 01 00 00 00 00 02 9D 00
					39 01 00 00 00 00 02 9E 00

					39 01 00 00 00 00 02 FF 27
					39 01 00 00 00 00 02 FB 01
					39 01 00 00 00 00 02 01 6C
					39 01 00 00 00 00 02 20 81
					39 01 00 00 00 00 02 21 6B
					39 01 00 00 00 00 02 25 81
					39 01 00 00 00 00 02 26 96
					39 01 00 00 00 00 02 6E 23
					39 01 00 00 00 00 02 6F 01
					39 01 00 00 00 00 02 70 00
					39 01 00 00 00 00 02 71 00
					39 01 00 00 00 00 02 72 00
					39 01 00 00 00 00 02 73 21
					39 01 00 00 00 00 02 74 03
					39 01 00 00 00 00 02 75 00
					39 01 00 00 00 00 02 76 00
					39 01 00 00 00 00 02 77 00
					39 01 00 00 00 00 02 7D 09
					39 01 00 00 00 00 02 7E 6F
					39 01 00 00 00 00 02 80 23
					39 01 00 00 00 00 02 82 09
					39 01 00 00 00 00 02 83 6F
					39 01 00 00 00 00 02 88 03
					39 01 00 00 00 00 02 89 01
					39 01 00 00 00 00 02 E3 01
					39 01 00 00 00 00 02 E4 E4
					39 01 00 00 00 00 02 E5 02
					39 01 00 00 00 00 02 E6 D7
					39 01 00 00 00 00 02 E9 02
					39 01 00 00 00 00 02 EA 1D
					39 01 00 00 00 00 02 EB 03
					39 01 00 00 00 00 02 EC 2B

					39 01 00 00 00 00 02 FF 2A
					39 01 00 00 00 00 02 FB 01
					39 01 00 00 00 00 02 15 0E
					39 01 00 00 00 00 02 16 B9
					39 01 00 00 00 00 02 19 0E
					39 01 00 00 00 00 02 1A 8D
					39 01 00 00 00 00 02 29 14
					39 01 00 00 00 00 02 2A 11
					39 01 00 00 00 00 02 2F 02
					39 01 00 00 00 00 02 30 4C
					39 01 00 00 00 00 02 31 09
					39 01 00 00 00 00 02 33 2F
					39 01 00 00 00 00 02 35 40
					39 01 00 00 00 00 02 36 6D
					39 01 00 00 00 00 02 38 45
					39 01 00 00 00 00 02 39 68
					39 01 00 00 00 00 02 3A 4C
					39 01 00 00 00 00 02 4E 0E
					39 01 00 00 00 00 02 4F B9
					39 01 00 00 00 00 02 52 0E
					39 01 00 00 00 00 02 53 8D
					39 01 00 00 00 00 02 61 EE
					39 01 00 00 00 00 02 62 0B
					39 01 00 00 00 00 02 63 FE
					39 01 00 00 00 00 02 65 05
					39 01 00 00 00 00 02 66 02
					39 01 00 00 00 00 02 67 4A
					39 01 00 00 00 00 02 68 B4
					39 01 00 00 00 00 02 6A EA
					39 01 00 00 00 00 02 6B F0
					39 01 00 00 00 00 02 6C 30
					39 01 00 00 00 00 02 6D 02
					39 01 00 00 00 00 02 6E EB
					39 01 00 00 00 00 02 6F 34
					39 01 00 00 00 00 02 70 FE
					39 01 00 00 00 00 02 71 0A
					39 01 00 00 00 00 02 83 0E
					39 01 00 00 00 00 02 84 B9
					39 01 00 00 00 00 02 87 0E
					39 01 00 00 00 00 02 88 8D
					39 01 00 00 00 00 02 95 80
					39 01 00 00 00 00 02 96 A0
					39 01 00 00 00 00 02 97 04
					39 01 00 00 00 00 02 98 00
					39 01 00 00 00 00 02 9A 03
					39 01 00 00 00 00 02 9B 01
					39 01 00 00 00 00 02 9C 05
					39 01 00 00 00 00 02 9D 7A
					39 01 00 00 00 00 02 9F F1
					39 01 00 00 00 00 02 A0 A2
					39 01 00 00 00 00 02 A2 21
					39 01 00 00 00 00 02 A3 AC
					39 01 00 00 00 00 02 A4 9F
					39 01 00 00 00 00 02 A5 23
					39 01 00 00 00 00 02 A6 AA
					39 01 00 00 00 00 02 A7 05

					39 01 00 00 00 00 02 FF 2C
					39 01 00 00 00 00 02 FB 01
					39 01 00 00 00 00 02 00 02
					39 01 00 00 00 00 02 01 02
					39 01 00 00 00 00 02 02 02
					39 01 00 00 00 00 02 03 13
					39 01 00 00 00 00 02 04 13
					39 01 00 00 00 00 02 05 13
					39 01 00 00 00 00 02 0D 01
					39 01 00 00 00 00 02 0E 01
					39 01 00 00 00 00 02 17 42
					39 01 00 00 00 00 02 18 42
					39 01 00 00 00 00 02 19 42
					39 01 00 00 00 00 02 2D AF
					39 01 00 00 00 00 02 2F 10
					39 01 00 00 00 00 02 30 EB
					39 01 00 00 00 00 02 32 00
					39 01 00 00 00 00 02 33 EB
					39 01 00 00 00 00 02 35 14
					39 01 00 00 00 00 02 37 14
					39 01 00 00 00 00 02 4D 12
					39 01 00 00 00 00 02 4E 02
					39 01 00 00 00 00 02 4F 0B
					39 01 00 00 00 00 02 53 02
					39 01 00 00 00 00 02 54 02
					39 01 00 00 00 00 02 55 02
					39 01 00 00 00 00 02 56 20
					39 01 00 00 00 00 02 58 20
					39 01 00 00 00 00 02 59 20
					39 01 00 00 00 00 02 61 01
					39 01 00 00 00 00 02 62 01
					39 01 00 00 00 00 02 6B 69
					39 01 00 00 00 00 02 6C 69
					39 01 00 00 00 00 02 6D 69
					39 01 00 00 00 00 02 80 AF
					39 01 00 00 00 00 02 81 10
					39 01 00 00 00 00 02 82 EB
					39 01 00 00 00 00 02 84 00
					39 01 00 00 00 00 02 85 EB
					39 01 00 00 00 00 02 87 1E
					39 01 00 00 00 00 02 89 1E
					39 01 00 00 00 00 02 9D 1F
					39 01 00 00 00 00 02 9E 02
					39 01 00 00 00 00 02 9F 0B

					39 01 00 00 00 00 02 FF E0
					39 01 00 00 00 00 02 FB 01
					39 01 00 00 00 00 02 35 82
					39 01 00 00 00 00 02 FF F0
					39 01 00 00 00 00 02 FB 01
					39 01 00 00 00 00 02 1C 01
					39 01 00 00 00 00 02 33 01
					39 01 00 00 00 00 02 5A 00
					39 01 00 00 00 00 02 FF D0
					39 01 00 00 00 00 02 FB 01
					39 01 00 00 00 00 02 53 22
					39 01 00 00 00 00 02 54 02

					39 01 00 00 00 00 02 FF C0
					39 01 00 00 00 00 02 FB 01
					39 01 00 00 00 00 02 9C 11
					39 01 00 00 00 00 02 9D 11

					39 01 00 00 00 00 02 FF 2B
					39 01 00 00 00 00 02 FB 01
					39 01 00 00 00 00 02 B7 18
					39 01 00 00 00 00 02 B8 17
					39 01 00 00 00 00 02 C0 05

					39 01 00 00 00 00 02 FF 20
					39 01 00 00 00 00 02 FB 01
					39 01 00 00 00 00 02 2F 83

					39 01 00 00 00 00 02 FF 2B
					39 01 00 00 00 00 02 FB 01
					39 01 00 00 00 00 02 B7 1A
					39 01 00 00 00 00 02 B8 14
					39 01 00 00 00 00 02 C0 05

					39 01 00 00 00 00 02 FF 10
					39 01 00 00 00 00 02 FB 01
					39 01 00 00 00 00 02 53 2C
					39 01 00 00 00 00 02 55 00

					//39 01 00 00 00 00 02 FF 20
					//39 01 00 00 00 00 02 FB 01
					//39 01 00 00 00 00 02 86 03

					39 01 00 00 64 00 02 11 00
					39 01 00 00 00 00 02 35 00
					39 01 00 00 0A 00 02 29 00
				];
				qcom,mdss-dsi-pre-off-command = [
					39 01 00 00 00 00 02 53 24
					39 01 00 00 00 00 03 51 00 00
				];
				qcom,mdss-dsi-off-command = [
					39 01 00 00 14 00 02 28 00
					39 01 00 00 78 00 02 10 00
				];
				qcom,mdss-dsi-cabc-mode1-command = [
					39 01 00 00 00 00 02 FF 10
					39 01 00 00 00 00 02 FB 01
					39 01 00 00 00 00 02 55 01
				];
				qcom,mdss-dsi-cabc-mode2-command = [
					39 01 00 00 00 00 02 FF 10
					39 01 00 00 00 00 02 FB 01
					39 01 00 00 00 00 02 55 02
				];
				qcom,mdss-dsi-cabc-mode3-command = [
					39 01 00 00 00 00 02 FF 10
					39 01 00 00 00 00 02 FB 01
					39 01 00 00 00 00 02 55 03
				];
				qcom,mdss-dsi-cabc-off-command = [
					39 01 00 00 00 00 02 FF 10
					39 01 00 00 00 00 02 FB 01
					39 01 00 00 00 00 02 55 00
				];
				qcom,mdss-dsi-backlight-gamma-enter-command = [
					//CMD2_Page0
					39 00 00 00 00 00 02 FF 20
					39 00 00 00 00 00 02 FB 01
					39 00 00 00 00 00 02 95 09
					39 00 00 00 00 00 02 96 09

					//CMD2_Page0
					39 00 00 00 00 00 02 FF 20
					39 00 00 00 00 00 02 FB 01
					//R(+)
					39 00 00 00 00 00 11 B0 00 00 00 05 00 0D 00 15 00 1D 00 24 00 2B 00 31
					39 00 00 00 00 00 11 B1 00 38 00 4F 00 65 00 8D 00 B2 00 F9 01 40 01 42
					39 00 00 00 00 00 11 B2 01 8D 01 E8 02 2E 02 7B 02 B2 02 F4 03 07 03 1B
					39 00 00 00 00 00 0F B3 03 31 03 4A 03 69 03 90 03 B6 03 BC 00 00
					//G(+)
					39 00 00 00 00 00 11 B4 00 00 00 05 00 0D 00 15 00 1D 00 24 00 2B 00 31
					39 00 00 00 00 00 11 B5 00 38 00 4F 00 65 00 8D 00 B2 00 F9 01 40 01 42
					39 00 00 00 00 00 11 B6 01 8D 01 E8 02 2E 02 7B 02 B2 02 F4 03 07 03 1B
					39 00 00 00 00 00 0F B7 03 31 03 4A 03 69 03 90 03 B6 03 BC 00 00
					//B(+)
					39 00 00 00 00 00 11 B8 00 00 00 05 00 0D 00 15 00 1D 00 24 00 2B 00 31
					39 00 00 00 00 00 11 B9 00 38 00 4F 00 65 00 8D 00 B2 00 F9 01 40 01 42
					39 00 00 00 00 00 11 BA 01 8D 01 E8 02 2E 02 7B 02 B2 02 F4 03 07 03 1B
					39 00 00 00 00 00 0F BB 03 31 03 4A 03 69 03 90 03 B6 03 BC 00 00
					//CMD2_Page1
					39 00 00 00 00 00 02 FF 21
					39 00 00 00 00 00 02 FB 01
					//R(-)
					39 00 00 00 00 00 11 B0 00 00 00 05 00 0D 00 15 00 1D 00 24 00 2B 00 31
					39 00 00 00 00 00 11 B1 00 38 00 4F 00 65 00 8D 00 B2 00 F9 01 40 01 42
					39 00 00 00 00 00 11 B2 01 8D 01 E8 02 2E 02 7B 02 B2 02 F4 03 07 03 1B
					39 00 00 00 00 00 0F B3 03 31 03 4A 03 69 03 90 03 B6 03 BC 00 00
					//G(-)
					39 00 00 00 00 00 11 B4 00 00 00 05 00 0D 00 15 00 1D 00 24 00 2B 00 31
					39 00 00 00 00 00 11 B5 00 38 00 4F 00 65 00 8D 00 B2 00 F9 01 40 01 42
					39 00 00 00 00 00 11 B6 01 8D 01 E8 02 2E 02 7B 02 B2 02 F4 03 07 03 1B
					39 00 00 00 00 00 0F B7 03 31 03 4A 03 69 03 90 03 B6 03 BC 00 00
					//B(-)
					39 00 00 00 00 00 11 B8 00 00 00 05 00 0D 00 15 00 1D 00 24 00 2B 00 31
					39 00 00 00 00 00 11 B9 00 38 00 4F 00 65 00 8D 00 B2 00 F9 01 40 01 42
					39 00 00 00 00 00 11 BA 01 8D 01 E8 02 2E 02 7B 02 B2 02 F4 03 07 03 1B
					39 00 00 00 00 00 0F BB 03 31 03 4A 03 69 03 90 03 B6 03 BC 00 00
					//CMD1_Page0
					39 01 00 00 00 00 02 FF 10
				];
				qcom,mdss-dsi-backlight-gamma-exit-command = [
					//CMD2_Page0
					39 00 00 00 00 00 02 FF 20
					39 00 00 00 00 00 02 FB 01
					39 00 00 00 00 00 02 95 D1
					39 00 00 00 00 00 02 96 D1

					//CMD2_Page0
					39 00 00 00 00 00 02 FF 20
					39 00 00 00 00 00 02 FB 01
					//R(+)
					39 00 00 00 00 00 11 B0 00 00 00 20 00 47 00 65 00 7E 00 95 00 A9 00 BB
					39 00 00 00 00 00 11 B1 00 CC 01 06 01 2E 01 70 01 9E 01 E9 02 22 02 24
					39 00 00 00 00 00 11 B2 02 5B 02 99 02 C3 02 F7 03 1B 03 43 03 52 03 5F
					39 00 00 00 00 00 0F B3 03 70 03 82 03 98 03 AC 03 D0 03 D8 00 00
					//G(+)
					39 00 00 00 00 00 11 B4 00 00 00 20 00 47 00 65 00 7E 00 95 00 A9 00 BB
					39 00 00 00 00 00 11 B5 00 CC 01 06 01 2E 01 70 01 9E 01 E9 02 22 02 24
					39 00 00 00 00 00 11 B6 02 5B 02 99 02 C3 02 F7 03 1B 03 43 03 52 03 5F
					39 00 00 00 00 00 0F B7 03 70 03 82 03 98 03 AC 03 D0 03 D8 00 00
					//B(+)
					39 00 00 00 00 00 11 B8 00 00 00 20 00 47 00 65 00 7E 00 95 00 A9 00 BB
					39 00 00 00 00 00 11 B9 00 CC 01 06 01 2E 01 70 01 9E 01 E9 02 22 02 24
					39 00 00 00 00 00 11 BA 02 5B 02 99 02 C3 02 F7 03 1B 03 43 03 52 03 5F
					39 00 00 00 00 00 0F BB 03 70 03 82 03 98 03 AC 03 D0 03 D8 00 00
					//CMD2_Page1
					39 00 00 00 00 00 02 FF 21
					39 00 00 00 00 00 02 FB 01
					//R(-)
					39 00 00 00 00 00 11 B0 00 00 00 20 00 47 00 65 00 7E 00 95 00 A9 00 BB
					39 00 00 00 00 00 11 B1 00 CC 01 06 01 2E 01 70 01 9E 01 E9 02 22 02 24
					39 00 00 00 00 00 11 B2 02 5B 02 99 02 C3 02 F7 03 1B 03 43 03 52 03 5F
					39 00 00 00 00 00 0F B3 03 70 03 82 03 98 03 AC 03 D0 03 D8 00 00
					//G(-)
					39 00 00 00 00 00 11 B4 00 00 00 20 00 47 00 65 00 7E 00 95 00 A9 00 BB
					39 00 00 00 00 00 11 B5 00 CC 01 06 01 2E 01 70 01 9E 01 E9 02 22 02 24
					39 00 00 00 00 00 11 B6 02 5B 02 99 02 C3 02 F7 03 1B 03 43 03 52 03 5F
					39 00 00 00 00 00 0F B7 03 70 03 82 03 98 03 AC 03 D0 03 D8 00 00
					//B(-)
					39 00 00 00 00 00 11 B8 00 00 00 20 00 47 00 65 00 7E 00 95 00 A9 00 BB
					39 00 00 00 00 00 11 B9 00 CC 01 06 01 2E 01 70 01 9E 01 E9 02 22 02 24
					39 00 00 00 00 00 11 BA 02 5B 02 99 02 C3 02 F7 03 1B 03 43 03 52 03 5F
					39 00 00 00 00 00 0F BB 03 70 03 82 03 98 03 AC 03 D0 03 D8 00 00
					//CMD1_Page0
					39 01 00 00 00 00 02 FF 10
				];
				qcom,compression-mode = "dsc";
				qcom,mdss-dsc-slice-height = <12>;
				qcom,mdss-dsc-slice-width = <540>;
				qcom,mdss-dsc-slice-per-pkt = <1>;
				qcom,mdss-dsc-bit-per-component = <8>;
				qcom,mdss-dsc-bit-per-pixel = <8>;
				qcom,mdss-dsc-block-prediction-enable;
				qcom,mdss-dsi-on-command-state = "dsi_hs_mode";
				qcom,mdss-dsi-off-command-state = "dsi_hs_mode";
				qcom,mdss-dsi-cabc-mode1-command-state = "dsi_lp_mode";
				qcom,mdss-dsi-cabc-mode2-command-state = "dsi_lp_mode";
				qcom,mdss-dsi-cabc-mode3-command-state = "dsi_lp_mode";
				qcom,mdss-dsi-cabc-off-command-state = "dsi_lp_mode";
				qcom,mdss-dsi-pre-off-command-state = "dsi_lp_mode";
				qcom,mdss-dsi-backlight-gamma-enter-command-state = "dsi_hs_mode";
				qcom,mdss-dsi-backlight-gamma-exit-command-state = "dsi_hs_mode";
			};
		};
	};
};
